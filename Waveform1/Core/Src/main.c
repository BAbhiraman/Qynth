/* USER CODE BEGIN Header */
/**
 ******************************************************************************
 * @file           : main.c
 * @brief          : Main program body
 ******************************************************************************
 * @attention
 *
 * Copyright (c) 2025 STMicroelectronics.
 * All rights reserved.
 *
 * This software is licensed under terms that can be found in the LICENSE file
 * in the root directory of this software component.
 * If no LICENSE file comes with this software, it is provided AS-IS.
 *
 *SWO print tutorial: https://youtu.be/iR34qmfyZtU?si=ymslVCKYRUU1sUiR
 *
 ******************************************************************************
 */
/* USER CODE END Header */
/* Includes ------------------------------------------------------------------*/
#include "main.h"

/* Private includes ----------------------------------------------------------*/
/* USER CODE BEGIN Includes */
#include <math.h>
#include <stdio.h>

/* USER CODE END Includes */

/* Private typedef -----------------------------------------------------------*/
/* USER CODE BEGIN PTD */

/* USER CODE END PTD */

/* Private define ------------------------------------------------------------*/
/* USER CODE BEGIN PD */
#define PI 3.1415926535897932384626433832795028841971693993751058209749445923078164062862089986280348253421170679
#define TAU (2.0 * PI)
#define BUFFER_SIZE 128 //Phil's lab used 128
#define INT16_TO_FLOAT 1.0f/(32767.0f)
#define FLOAT_TO_INT16 32767.0f
#define FS 48095.0f //see .ioc see for 48 kHz inaccuracy WAS 48000
#define SINE_LOOKUP_SIZE 4096
#define LOG_E2 (1.4426950408889634f)	// 1.0 / math.log(2.0)


// DAC PARAMS
#define DACADDR 0x94
#define CS43L22_REG_ID                              0x01
#define CS43L22_REG_Power_Ctl_1                     0x02
#define CS43L22_REG_Power_Ctl_2                     0x04
#define CS43L22_REG_Clocking_Ctl                    0x05
#define CS43L22_REG_Interface_Ctl_1                 0x06
#define CS43L22_REG_Interface_Ctl_2                 0x07
#define CS43L22_REG_Passthrough_A_Select            0x08
#define CS43L22_REG_Passthrough_B_Select            0x09
#define CS43L22_REG_Analog_ZC_and_SR_Settings       0x0A
#define CS43L22_REG_Passthrough_Gang_Control        0x0C
#define CS43L22_REG_Playback_Ctl_1                  0x0D
#define CS43L22_REG_Misc_Ctl                        0x0E
#define CS43L22_REG_Playback_Ctl_2                  0x0F
#define CS43L22_REG_Passthrough_A_Vol               0x14
#define CS43L22_REG_Passthrough_B_Vol               0x15
#define CS43L22_REG_PCMA_Vol                        0x1A
#define CS43L22_REG_PCMB_Vol                        0x1B
#define CS43L22_REG_BEEP_Freq_On_Time               0x1C
#define CS43L22_REG_BEEP_Vol_Off_Time               0x1D
#define CS43L22_REG_BEEP_Tone_Cfg                   0x1E
#define CS43L22_REG_Tone_Ctl                        0x1F
#define CS43L22_REG_Master_A_Vol                    0x20
#define CS43L22_REG_Master_B_Vol                    0x21
#define CS43L22_REG_Headphone_A_Volume              0x22
#define CS43L22_REG_Headphone_B_Volume              0x23
#define CS43L22_REG_Speaker_A_Volume                0x24
#define CS43L22_REG_Speaker_B_Volume                0x25
#define CS43L22_REG_Channel_Mixer_Swap              0x26
#define CS43L22_REG_Limit_Ctl_1_Thresholds          0x27
#define CS43L22_REG_Limit_Ctl_2_Release_Rate        0x28
#define CS43L22_REG_Limiter_Attack_Rate             0x29
#define CS43L22_REG_Overflow_Clock_Status           0x2E
#define CS43L22_REG_Battery_Compensation            0x2F
#define CS43L22_REG_VP_Battery_Level                0x30
#define CS43L22_REG_Speaker_Status                  0x31
#define CS43L22_REG_Charge_Pump_Frequency           0x34

#define ADR_TABLE_SIZE 256

typedef struct {
    uint8_t  pitch;             // MIDI standard pitch (0-127), 60 = middle C
    uint8_t  vel;     // MIDI standard velocity (0-127)
    uint8_t  released;        // True if the note has been released, false if pressed
    uint32_t ticks_pressed;   // Ticks elapsed since the note was pressed
    uint32_t ticks_released; // Ticks elapsed since the note was released (meaningful only if isReleased is true)
    float    env;     // Current envelope level (e.g., 0.0 to 1.0)
} Note;


/* USER CODE END PD */

/* Private macro -------------------------------------------------------------*/
/* USER CODE BEGIN PM */

/* USER CODE END PM */

/* Private variables ---------------------------------------------------------*/
ADC_HandleTypeDef hadc1;
DMA_HandleTypeDef hdma_adc1;

I2C_HandleTypeDef hi2c1;

I2S_HandleTypeDef hi2s3;
DMA_HandleTypeDef hdma_spi3_tx;

SPI_HandleTypeDef hspi1;

PCD_HandleTypeDef hpcd_USB_OTG_FS;

/* USER CODE BEGIN PV */
int16_t dacData[BUFFER_SIZE];
uint16_t AD_RES_BUFFER[3];
uint16_t AD_RES_COPY[3];

static volatile int16_t *outBufPtr = &dacData[0];
volatile uint8_t dataReadyFlag = 0; // added this = 0
volatile uint8_t writeFirstHalf = 0;
volatile uint64_t ticks = 0; //number of samples output
volatile uint64_t loops = 0;
volatile uint8_t  attack_ind = 180;
volatile uint8_t  decay_ind  = 180;
volatile uint8_t  release_ind = 68;
volatile Note myNote;
volatile Note myNote2;

int8_t odeToJoy[] =  {4,4,5,7,7,5,4,2,0,0,2,4,4,4,2,2,4,4,5,7,7,5,4,2,0,0,2,4,2,2,0,0};
int8_t odeToJoy2[] = {0, -5, -3, -1, -5, -3, -4, -1, -3, -4, -5, -6, -10, -6, -5, -1, 0, -5, -3, -1, -5, -3, -4, -1, -3, -4, -10, -6, -7, -5, -8, -12};

uint8_t lenJoy = sizeof(odeToJoy);

float ATTACK_TIME = 0.2; //units: seconds
float DECAY_TIME = 0.4; // time constant tau: seconds
float RELEASE_TIME = 0.4; // time constant tau: seconds
float SUSTAIN_LEVEL = 0.0;

float input_scale;

uint8_t prevNoteInd = 0;
volatile uint64_t ticksNote = 0;

double expTest[12000];

const float sineLookupTable[] = { //4096 entries. from https://deepbluembedded.com/sine-lookup-table-generator-calculator/
		0.0000000000e+00,1.5343547843e-03,3.0687059564e-03,4.6030499040e-03,6.1373830149e-03,7.6717016768e-03,9.2060022777e-03,1.0740281205e-02,1.2274534848e-02,1.3808759593e-02,1.5342951829e-02,1.6877107944e-02,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7.0615681024e-01,
		7.0724238732e-01,7.0832629937e-01,7.0940854385e-01,7.1048911821e-01,7.1156801990e-01,7.1264524638e-01,7.1372079513e-01,7.1479466359e-01,7.1586684926e-01,7.1693734960e-01,7.1800616209e-01,7.1907328422e-01,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9.9999933787e-01,
		9.9999992643e-01,9.9999816075e-01,9.9999404082e-01,9.9998756666e-01,9.9997873829e-01,9.9996755572e-01,9.9995401898e-01,9.9993812810e-01,9.9991988312e-01,9.9989928408e-01,9.9987633104e-01,9.9985102404e-01,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7.0778455163e-01,
		7.0669980675e-01,7.0561339812e-01,7.0452532830e-01,7.0343559986e-01,7.0234421536e-01,7.0125117736e-01,7.0015648845e-01,6.9906015120e-01,6.9796216818e-01,6.9686254200e-01,6.9576127522e-01,6.9465837046e-01,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7.6717761793e-04,
		-7.6717761793e-04,-2.3015310477e-03,-3.8358790590e-03,-5.3702180398e-03,-6.9045443777e-03,-8.4388544607e-03,-9.9731446765e-03,-1.1507411413e-02,-1.3041651058e-02,-1.4575860000e-02,-1.6110034627e-02,-1.7644171327e-02,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-7.0669980675e-01,
		-7.0778455163e-01,-7.0886763022e-01,-7.0994903995e-01,-7.1102877830e-01,-7.1210684270e-01,-7.1318323063e-01,-7.1425793955e-01,-7.1533096694e-01,-7.1640231025e-01,-7.1747196698e-01,-7.1853993461e-01,-7.1960621061e-01,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-9.9999992643e-01,
		-9.9999933787e-01,-9.9999639506e-01,-9.9999109802e-01,-9.9998344675e-01,-9.9997344127e-01,-9.9996108162e-01,-9.9994636780e-01,-9.9992929987e-01,-9.9990987786e-01,-9.9988810181e-01,-9.9986397178e-01,-9.9983748783e-01,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-7.0724238732e-01,
		-7.0615681024e-01,-7.0506957070e-01,-7.0398067125e-01,-7.0289011445e-01,-7.0179790288e-01,-7.0070403911e-01,-6.9960852570e-01,-6.9851136525e-01,-6.9741256033e-01,-6.9631211352e-01,-6.9521002743e-01,-6.9410630464e-01,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-2.4492935983e-16,

};
const float attackTable[] = { //256 elements
		5.0000000000e-04, 5.3083844279e-04, 5.6357890469e-04, 5.9833869632e-04, 6.3524236363e-04, 6.7442213421e-04, 7.1601839102e-04, 7.6018017540e-04, 8.0706572111e-04, 8.5684302125e-04, 9.0969043023e-04, 9.6579730282e-04,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 2.1701453424e-02,
		2.3039931484e-02, 2.4460962702e-02, 2.5969638700e-02, 2.7571365135e-02, 2.9271881068e-02, 3.1077279527e-02, 3.2994029341e-02, 3.5028998314e-02, 3.7189477835e-02, 3.9483209004e-02, 4.1918410369e-02, 4.4503807369e-02,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 1.0000000000e+00,
		1.0301861877e+00, 1.0612835814e+00, 1.0933196868e+00, 1.1263228402e+00, 1.1603222329e+00, 1.1953479376e+00, 1.2314309349e+00, 1.2686031403e+00, 1.3068974328e+00, 1.3463476841e+00, 1.3869887881e+00, 1.4288566920e+00,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 6.7082039325e+00,
		6.9106990358e+00, 7.1193066943e+00, 7.3342114228e+00, 7.5556033057e+00, 7.7836781656e+00, 8.0186377360e+00, 8.2606898401e+00, 8.5100485745e+00, 8.7669344984e+00, 9.0315748291e+00, 9.3042036424e+00, 9.5850620804e+00,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 4.5000000000e+01,
};

const float decayTable[] = {//256 elements
		3.0000000000e-03, 3.1404106514e-03, 3.2873930197e-03, 3.4412546848e-03, 3.6023176220e-03, 3.7709188766e-03, 3.9474112685e-03, 4.1321641310e-03, 4.3255640833e-03, 4.5280158402e-03, 4.7399430580e-03, 4.9617892220e-03,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 5.3533795290e-02,
		5.6039366979e-02, 5.8662208318e-02, 6.1407807945e-02, 6.4281911382e-02, 6.7290533065e-02, 7.0439968924e-02, 7.3736809564e-02, 7.7187954050e-02, 8.0800624352e-02, 8.4582380450e-02, 8.8541136161e-02, 9.2685175695e-02,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 1.0000000000e+00,
		1.0301861877e+00, 1.0612835814e+00, 1.0933196868e+00, 1.1263228402e+00, 1.1603222329e+00, 1.1953479376e+00, 1.2314309349e+00, 1.2686031403e+00, 1.3068974328e+00, 1.3463476841e+00, 1.3869887881e+00, 1.4288566920e+00,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 6.7082039325e+00,
		6.9106990358e+00, 7.1193066943e+00, 7.3342114228e+00, 7.5556033057e+00, 7.7836781656e+00, 8.0186377360e+00, 8.2606898401e+00, 8.5100485745e+00, 8.7669344984e+00, 9.0315748291e+00, 9.3042036424e+00, 9.5850620804e+00,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 4.5000000000e+0,
};

const float releaseTable[] = {//256 elements
		3.0000000000e-03, 3.1404106514e-03, 3.2873930197e-03, 3.4412546848e-03, 3.6023176220e-03, 3.7709188766e-03, 3.9474112685e-03, 4.1321641310e-03, 4.3255640833e-03, 4.5280158402e-03, 4.7399430580e-03, 4.9617892220e-03,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 5.3533795290e-02,
		5.6039366979e-02, 5.8662208318e-02, 6.1407807945e-02, 6.4281911382e-02, 6.7290533065e-02, 7.0439968924e-02, 7.3736809564e-02, 7.7187954050e-02, 8.0800624352e-02, 8.4582380450e-02, 8.8541136161e-02, 9.2685175695e-02,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 1.0000000000e+00,
		1.0301861877e+00, 1.0612835814e+00, 1.0933196868e+00, 1.1263228402e+00, 1.1603222329e+00, 1.1953479376e+00, 1.2314309349e+00, 1.2686031403e+00, 1.3068974328e+00, 1.3463476841e+00, 1.3869887881e+00, 1.4288566920e+00,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 6.7082039325e+00,
		6.9106990358e+00, 7.1193066943e+00, 7.3342114228e+00, 7.5556033057e+00, 7.7836781656e+00, 8.0186377360e+00, 8.2606898401e+00, 8.5100485745e+00, 8.7669344984e+00, 9.0315748291e+00, 9.3042036424e+00, 9.5850620804e+00,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 4.5000000000e+0,
};

float k_attackTable[ADR_TABLE_SIZE]; //these are decay coefficients. Each time step, multiply envelope by these.
float k_decayTable[ADR_TABLE_SIZE];
float k_releaseTable[ADR_TABLE_SIZE];

/* USER CODE END PV */

/* Private function prototypes -----------------------------------------------*/
void SystemClock_Config(void);
static void MX_GPIO_Init(void);
static void MX_DMA_Init(void);
static void MX_I2C1_Init(void);
static void MX_I2S3_Init(void);
static void MX_SPI1_Init(void);
static void MX_USB_OTG_FS_PCD_Init(void);
static void MX_ADC1_Init(void);
/* USER CODE BEGIN PFP */

/* USER CODE END PFP */

/* Private user code ---------------------------------------------------------*/
/* USER CODE BEGIN 0 */
void HAL_ADC_ConvCpltCallback(ADC_HandleTypeDef* hadc) {
	for (int i = 0; i < 3; i++) {
		AD_RES_COPY[i] = AD_RES_BUFFER[i];
		//printf("%d\r\n",AD_RES_COPY[i]);
	}
	//printf("\r\n");
	//HAL_ADC_Start_DMA(&hadc1, (uint32_t *) AD_RES_BUFFER, 3);
}


void HAL_I2S_TxHalfCpltCallback(I2S_HandleTypeDef *hi2s) {
	HAL_GPIO_TogglePin(GPIOD, LD4_Pin); //green
	outBufPtr = &dacData[0];
	dataReadyFlag = 1;
	//processData(1);
}

void HAL_I2S_TxCpltCallback(I2S_HandleTypeDef *hi2s) {
	HAL_GPIO_TogglePin(GPIOD, LD3_Pin);
	outBufPtr = &dacData[BUFFER_SIZE / 2];
	dataReadyFlag = 1;
	//processData(0);
}

void populate_ADR_tables() {
    // Populate resultArray based on attackTable and FS
    for (int i = 0; i < ADR_TABLE_SIZE; i++) {
    	k_attackTable[i] = expf(-1.0f / (attackTable[i] * FS));
    	k_decayTable[i] = expf(-1.0f / (decayTable[i] * FS));
    	k_releaseTable[i] = expf(-1.0f / (releaseTable[i] * FS));
    }
    // Max decay should yield NO decay, so just hardcode that
    k_attackTable[ADR_TABLE_SIZE - 1] = 1.0f;
}

// from googoomuck https://github.com/deadsy/googoomuck/blob/23a4c42d906d39d54b2561419264b4d8862aaff6/ggm/pow.c#L59

//Notes:
//
//math library powf(2.f, x) = 4.58uS
//math library truncf() = 300nS
//
//pow2_frac() = 186nS
//pow2() = 500nS

static const uint16_t exp0_table[64] = {
	0x8000, 0x8165, 0x82ce, 0x843a, 0x85ab, 0x871f, 0x8898, 0x8a15, 0x8b96, 0x8d1b, 0x8ea4, 0x9032, 0x91c4, 0x935a, 0x94f5, 0x9694,
	0x9838, 0x99e0, 0x9b8d, 0x9d3f, 0x9ef5, 0xa0b0, 0xa270, 0xa435, 0xa5ff, 0xa7ce, 0xa9a1, 0xab7a, 0xad58, 0xaf3b, 0xb124, 0xb312,
	0xb505, 0xb6fe, 0xb8fc, 0xbaff, 0xbd09, 0xbf18, 0xc12c, 0xc347, 0xc567, 0xc78d, 0xc9ba, 0xcbec, 0xce25, 0xd063, 0xd2a8, 0xd4f3,
	0xd745, 0xd99d, 0xdbfc, 0xde61, 0xe0cd, 0xe340, 0xe5b9, 0xe839, 0xeac1, 0xed4f, 0xefe5, 0xf281, 0xf525, 0xf7d1, 0xfa84, 0xfd3e,
};

static const uint16_t exp1_table[64] = {
	0x8000, 0x8006, 0x800b, 0x8011, 0x8016, 0x801c, 0x8021, 0x8027, 0x802c, 0x8032, 0x8037, 0x803d, 0x8043, 0x8048, 0x804e, 0x8053,
	0x8059, 0x805e, 0x8064, 0x806a, 0x806f, 0x8075, 0x807a, 0x8080, 0x8085, 0x808b, 0x8090, 0x8096, 0x809c, 0x80a1, 0x80a7, 0x80ac,
	0x80b2, 0x80b8, 0x80bd, 0x80c3, 0x80c8, 0x80ce, 0x80d3, 0x80d9, 0x80df, 0x80e4, 0x80ea, 0x80ef, 0x80f5, 0x80fa, 0x8100, 0x8106,
	0x810b, 0x8111, 0x8116, 0x811c, 0x8122, 0x8127, 0x812d, 0x8132, 0x8138, 0x813e, 0x8143, 0x8149, 0x814e, 0x8154, 0x815a, 0x815f,
};

// return powf(2.f, x) where x is an integer [-126,127]
float pow2_int(int x) {
	float f;
	// make a float32 per IEEE754
	*(uint32_t *) & f = (127 + x) << 23;
	return f;
}

// return powf(2.f, x) where x = [0,1)
float pow2_frac(float x) {
	int n = (int)(x * (float)(1U << 12));
	uint16_t x0 = exp0_table[(n >> 6) & 0x3f];
	uint16_t x1 = exp1_table[n & 0x3f];
	return (float)(x0 * x1) * (1.f / (float)(1U << 30));
}

// return powf(2.f, x)
float pow2(float x) {
	float nf = truncf(x);
	float ff = x - nf;
	if (ff < 0) {
		nf -= 1.f;
		ff += 1.f;
	}
	return pow2_frac(ff) * pow2_int((int)nf);
}

// return powf(e, x)
float powe(float x) {
	return pow2(LOG_E2 * x);
}

double min(double a, double b) {
	  return (a < b) ? a : b;
}

// Note management functions

Note Note_init(uint8_t pitch, uint8_t velocity) {
    Note newNote;

    // Initialize the core properties from function arguments
    newNote.pitch         = pitch;
    newNote.vel = velocity;

    // Set default initial state for a newly pressed note
    newNote.released      = 0;    // A new note is always initially pressed
    newNote.ticks_pressed = 0;        // No ticks have elapsed yet
    newNote.ticks_released = 0;      // Not applicable for a pressed note
    newNote.env   = 0.0f;     // Start at zero level (will typically ramp up during attack phase)

    return newNote;
}

void updateNoteEnvelope(Note* note_ptr, float attack_time_sec, float decay_k, float release_k) {
    // Ensure note_ptr is not NULL
    if (note_ptr == NULL) {
        printf("Error: NULL Note pointer passed to updateNoteEnvelope.\r\n");
        return;
    }
    // Calculate attack duration in ticks
    // Ensure FS_hz is not zero to prevent division by zero in attack_increment_per_tick
    float attack_duration_ticks = (FS > 0) ? (attack_time_sec * FS) : 1.0f; // Prevent div by zero if FS_hz is 0

    // If the note is currently pressed (not released)
    if (note_ptr->released == 0) {
        note_ptr->ticks_pressed++; // Increment ticks since press

        // Attack Phase: if ticks_pressed is within the attack duration
        if (note_ptr->ticks_pressed <= attack_duration_ticks) {
            // Calculate the linear increment per tick
            // If attack_duration_ticks is 0 (e.g., attack_time_sec is 0),
            // we should jump straight to 1.0 or handle it as instant attack.
            if (attack_duration_ticks > 0) {
                float attack_increment_per_tick = 1.0f / attack_duration_ticks;
                note_ptr->env += attack_increment_per_tick;
            } else { // Instant attack
                note_ptr->env = 1.0f;
            }
            // Clip the envelope level at 1.0 (maximum)
            note_ptr->env = fminf(note_ptr->env, 1.0f);
        }
        // Decay Phase: if attack is finished and note is still pressed
        else {
            note_ptr->env *= decay_k;
            // Ensure envelope doesn't go below 0 due to floating point inaccuracies
            note_ptr->env = fmaxf(note_ptr->env, 0.0f);
        }
    }
    // If the note has been released
    else {
        note_ptr->ticks_released++; // Increment ticks since release
        // Release Phase: apply release scalar
        note_ptr->env *= release_k;
        // Ensure envelope doesn't go below 0
        note_ptr->env = fmaxf(note_ptr->env, 0.0f);
    }
}

void processData() {
	//navflag
	if (outBufPtr == &dacData[0]) {
		HAL_GPIO_WritePin(GPIOD, LD6_Pin, GPIO_PIN_SET); //blue
	}
	else {
		HAL_GPIO_WritePin(GPIOD, LD5_Pin, GPIO_PIN_SET); //red
	}
	static float leftOut, rightOut;
	static int16_t leftOutInt, rightOutInt;
	float vibrato;
	float f;
	float f2;
	float tNote;
	//double phase;
	uint16_t phase = 0;
	uint16_t phase2 = 0;
	uint16_t phase_vib = 0;
	uint8_t noteInd = ((uint8_t)(loops/1600)) % lenJoy;
	uint8_t vibrato_amt;
	if (noteInd != prevNoteInd) {
		myNote = Note_init(36 + odeToJoy[noteInd], 100);  // Middle C = 60, velocity 100
		myNote2 = Note_init(36 + odeToJoy2[noteInd], 100);
	}
	prevNoteInd = noteInd;


	//printf("%u\r\n",noteInd);
	f = 65.41*pow(1.0594630943592952646,myNote.pitch); // + 4*sinf(1.5*TAU*t);
	f2 = 65.41*pow(1.0594630943592952646,myNote2.pitch);
	//printf("%d \r\n", odeToJoy[noteInd]);
	for (uint16_t n = 0; n < (BUFFER_SIZE / 2) - 1; n += 2) {

		//t = (ticks)/(float)FS;
		tNote = (myNote.ticks_pressed)/(float)FS;
											//vibrato 0.5 to 60 Hz or so
		vibrato_amt = 255-AD_RES_COPY[1];
		if (vibrato_amt > 10) vibrato_amt -= 10;
		phase_vib = ((uint16_t)(SINE_LOOKUP_SIZE *((vibrato_amt)/15.0)*tNote)) % SINE_LOOKUP_SIZE;
		vibrato = 1.0 + 0.0025*sineLookupTable[phase_vib]; //6% is approximately 12th root of 2. Idk why this fraction is so small

		phase = ((uint16_t)(SINE_LOOKUP_SIZE *f*vibrato*tNote)) % SINE_LOOKUP_SIZE;
		phase2 = ((uint16_t)(SINE_LOOKUP_SIZE *f2*vibrato*tNote)) % SINE_LOOKUP_SIZE; //todo change tNote
		leftOut = (sineLookupTable[phase] * myNote.env + sineLookupTable[phase2] * myNote2.env);
		// Potentiometers connected to PC1 (attack), PA1 (decay), PA3 (release)
		updateNoteEnvelope(&myNote, attackTable[255-AD_RES_COPY[2]], k_decayTable[255-AD_RES_COPY[0]], k_releaseTable[255-AD_RES_COPY[1]]);
		updateNoteEnvelope(&myNote2, attackTable[255-AD_RES_COPY[2]], k_decayTable[255-AD_RES_COPY[0]], k_releaseTable[255-AD_RES_COPY[1]]);
		//updateNoteEnvelope(&myNote, attackTable[100], k_decayTable[100], k_releaseTable[100]);

		//rightOut = leftOut;
		outBufPtr[n] = (int16_t)(FLOAT_TO_INT16 * leftOut/2.0); //(10000 * leftOut); //15k worked, 25k worked, 30k worked, 32767 worked, 32768 OVERFLOWs andcr
		outBufPtr[n + 1] = outBufPtr[n]; //(10000 * rightOut);
		ticks++;

	}
	loops++;
	//	printf("\r\n");
	dataReadyFlag = 0;
	HAL_GPIO_WritePin(GPIOD, LD6_Pin, GPIO_PIN_RESET); //blue
	HAL_GPIO_WritePin(GPIOD, LD5_Pin, GPIO_PIN_RESET); //red

}

// CS43L22 Stereo DAC driver by https://github.com/deadsy/googoomuck/blob/master/drivers/cs43l22.h
enum {
	DAC_OUTPUT_OFF,		// must be 0
	DAC_OUTPUT_SPEAKER,
	DAC_OUTPUT_HEADPHONE,
	DAC_OUTPUT_BOTH,
	DAC_OUTPUT_AUTO,
	DAC_OUTPUT_MAX,		// must be last
};

struct cs4x_cfg {
	//struct i2c_drv *i2c;	// i2c bus
	uint8_t adr;		// device i2c bus address
	//int rst;		// gpio for reset pin
	int out;		// output device
};

struct cs4x_drv {
	struct cs4x_cfg cfg;
};

HAL_StatusTypeDef i2c_wr(uint8_t *buf, uint8_t Nbytes) {
	HAL_StatusTypeDef rc;
	rc = HAL_I2C_Master_Transmit(&hi2c1, DACADDR, buf, Nbytes, HAL_MAX_DELAY);
	return rc;
}

HAL_StatusTypeDef i2c_rd(uint8_t *buf, uint8_t Nbytes) {
	HAL_StatusTypeDef rc;
	rc = HAL_I2C_Master_Receive(&hi2c1, DACADDR, buf, Nbytes, HAL_MAX_DELAY);
	return rc;
}
// read a dac register
static int cs4x_rd(struct cs4x_drv *dac, uint8_t reg, uint8_t *val) {
	uint8_t buf[1] = { reg };
	int rc;
	rc = i2c_wr(buf, 1);
	if (rc != 0) {
		return rc;
	}
	rc = i2c_rd(buf, 1);
	if (rc != 0) {
		return rc;
	}
	*val = buf[0];
	return 0;
}

// write a dac register
static int cs4x_wr(struct cs4x_drv *dac, uint8_t reg, uint8_t val) {
	uint8_t buf[2] = { reg, val };
	return i2c_wr(buf, 2);
}

// read/modify/write a register
static int cs4x_rmw(struct cs4x_drv *dac, uint8_t reg, uint8_t mask,
		uint8_t val) {
	uint8_t x;
	int rc;
	rc = cs4x_rd(dac, reg, &x);
	if (rc != 0) {
		return rc;
	}
	x &= ~mask;
	x |= val & mask;
	return cs4x_wr(dac, reg, x);
}

// set bits in a register
static int cs4x_set(struct cs4x_drv *dac, uint8_t reg, uint8_t bits) {
	return cs4x_rmw(dac, reg, bits, 0xff);
}

// clear bits in a register
static int cs4x_clr(struct cs4x_drv *dac, uint8_t reg, uint8_t bits) {
	return cs4x_rmw(dac, reg, bits, 0);
}

//-----------------------------------------------------------------------------

// read and verify the device id
static int cs4x_id(struct cs4x_drv *dac) {
	uint8_t id;
	int rc;
	rc = cs4x_rd(dac, CS43L22_REG_ID, &id);
	if (rc != 0) {
		return rc;
	}
	if ((id & 0xf8) != 0xe0) {
		return -1;
	}
	return 0;
}

//-----------------------------------------------------------------------------

// set the output device
int cs4x_output(struct cs4x_drv *dac, unsigned int out) {
	const uint8_t ctrl[DAC_OUTPUT_MAX] = { 0xff, 0xfa, 0xaf, 0xaa, 0x05 };
	int rc;
	if (out >= DAC_OUTPUT_MAX) {
		out = DAC_OUTPUT_OFF;
	}
	rc = cs4x_wr(dac, CS43L22_REG_Power_Ctl_2, ctrl[out]);
	if (rc != 0) {
		return rc;
	}
	dac->cfg.out = out;
	return 0;
}

//-----------------------------------------------------------------------------
// volume controls
// Map 0..255 to the control value for a volume register.
// 0 is minium volume (or mute), 255 is maximum volume.

// set the master volume
int cs4x_master_volume(struct cs4x_drv *dac, uint8_t vol) {
	uint32_t x;
	int rc;
	x = (((281 - 52) << 16) / 255) * vol + (52 << 16);
	x >>= 16;
	x &= 255;
	rc = cs4x_wr(dac, CS43L22_REG_Master_A_Vol, x);
	rc |= cs4x_wr(dac, CS43L22_REG_Master_B_Vol, x);
	return rc;
}

// set the headphone volume
int cs4x_headphone_volume(struct cs4x_drv *dac, uint8_t vol) {
	uint32_t x;
	int rc;
	if (vol == 0) {
		x = 1;		// muted
	} else {
		x = (((257 - 52) << 16) / 255) * (vol - 1) + (52 << 16);
		x >>= 16;
		x &= 255;
	}
	rc = cs4x_wr(dac, CS43L22_REG_Headphone_A_Volume, x);
	rc |= cs4x_wr(dac, CS43L22_REG_Headphone_B_Volume, x);
	return rc;
}

// set the speaker volume
int cs4x_speaker_volume(struct cs4x_drv *dac, uint8_t vol) {
	uint32_t x;
	int rc;
	if (vol == 0) {
		x = 1;		// muted
	} else {
		x = (((257 - 64) << 16) / 255) * (vol - 1) + (64 << 16);
		x >>= 16;
		x &= 255;
	}
	rc = cs4x_wr(dac, CS43L22_REG_Speaker_A_Volume, x);
	rc |= cs4x_wr(dac, CS43L22_REG_Speaker_B_Volume, x);
	return rc;
}

// set the pcm volume
int cs4x_pcm_volume(struct cs4x_drv *dac, uint8_t vol) {
	uint32_t x;
	int rc;
	if (vol == 0) {
		x = 0x80;	// muted
	} else {
		x = (((281 - 25) << 16) / (255 - 1)) * (vol - 1) + (25 << 16);
		x >>= 16;
		x &= 255;
	}
	rc = cs4x_wr(dac, CS43L22_REG_PCMA_Vol, x);
	rc |= cs4x_wr(dac, CS43L22_REG_PCMB_Vol, x);
	return rc;
}

//-----------------------------------------------------------------------------
// mute on/off

static int cs4x_mute_on(struct cs4x_drv *dac) {
	int rc = cs4x_wr(dac, CS43L22_REG_Power_Ctl_2, 0xff);
	rc |= cs4x_headphone_volume(dac, 0);
	return rc;
}

static int cs4x_mute_off(struct cs4x_drv *dac) {
	int rc = cs4x_headphone_volume(dac, 0xff);
	rc |= cs4x_output(dac, dac->cfg.out);
	return rc;
}

//-----------------------------------------------------------------------------

int cs4x_init(struct cs4x_drv *dac, struct cs4x_cfg *cfg) {
	int rc;

	memset(dac, 0, sizeof(struct cs4x_drv));
	dac->cfg = *cfg;

	// 4.9 Recommended Power-Up Sequence (1,2)
	// reset the dac
	// DAC Reset is active low, so pull the pin high.
	HAL_GPIO_WritePin(Audio_RST_GPIO_Port, Audio_RST_Pin, GPIO_PIN_RESET);
	HAL_GPIO_WritePin(Audio_RST_GPIO_Port, Audio_RST_Pin, GPIO_PIN_SET);

	rc = cs4x_id(dac);
	if (rc != 0) {
		printf("cs4x bad device id %d\r\n", rc);
		goto exit;
	}
	// 4.9 Recommended Power-Up Sequence (4)
	// 4.11 Required Initialization Settings
	rc |= cs4x_wr(dac, 0, 0x99);
	rc |= cs4x_wr(dac, 0x47, 0x80);
	rc |= cs4x_set(dac, 0x32, 1 << 7);
	rc |= cs4x_clr(dac, 0x32, 1 << 7);
	rc |= cs4x_wr(dac, 0, 0);

	// set the output to AUTO
	rc |= cs4x_output(dac, DAC_OUTPUT_AUTO);
	// Clock configuration: Auto detection
	rc |= cs4x_wr(dac, CS43L22_REG_Clocking_Ctl, 0x81);
	// Set the Slave Mode and the audio Standard
	rc |= cs4x_wr(dac, CS43L22_REG_Interface_Ctl_1, 0x04);

	// Set the Master volume
	rc |= cs4x_master_volume(dac, 169);

	// If the Speaker is enabled, set the Mono mode and volume attenuation level
	if (dac->cfg.out != DAC_OUTPUT_OFF
			&& dac->cfg.out != DAC_OUTPUT_HEADPHONE) {
		// Set the Speaker Mono mode
		rc |= cs4x_wr(dac, CS43L22_REG_Playback_Ctl_2, 0x06);
		rc |= cs4x_speaker_volume(dac, 0xff);
	}
	// Additional configuration for the CODEC. These configurations are done to reduce
	// the time needed for the Codec to power off. If these configurations are removed,
	// then a long delay should be added between powering off the Codec and switching
	// off the I2S peripheral MCLK clock (which is the operating clock for Codec).
	// If this delay is not inserted, then the codec will not shut down properly and
	// it results in high noise after shut down.

	// Disable the analog soft ramp
	rc |= cs4x_rmw(dac, CS43L22_REG_Analog_ZC_and_SR_Settings, 0x0f, 0x00);
	// Disable the digital soft ramp
	rc |= cs4x_wr(dac, CS43L22_REG_Misc_Ctl, 0x04);
	// Disable the limiter attack level
	rc |= cs4x_wr(dac, CS43L22_REG_Limit_Ctl_1_Thresholds, 0x00);
	// Adjust Bass and Treble levels
	rc |= cs4x_wr(dac, CS43L22_REG_Tone_Ctl, 0x0f);
	// Adjust PCM volume level
	rc |= cs4x_pcm_volume(dac, 241);

	exit: return rc;
}

//-----------------------------------------------------------------------------

int cs4x_start(struct cs4x_drv *dac) {
	// Enable the digital soft ramp
	int rc = cs4x_wr(dac, CS43L22_REG_Misc_Ctl, 0x06);
	// Enable Output device
	rc |= cs4x_mute_off(dac);
	// Power on the Codec
	rc |= cs4x_wr(dac, CS43L22_REG_Power_Ctl_1, 0x9e);
	return rc;
}

int cs4x_stop(struct cs4x_drv *dac) {
	// Mute the output
	int rc = cs4x_mute_on(dac);
	// Disable the digital soft ramp
	rc |= cs4x_wr(dac, CS43L22_REG_Misc_Ctl, 0x04);
	// Power down the DAC and the speaker (PMDAC and PMSPK bits)
	rc |= cs4x_wr(dac, CS43L22_REG_Power_Ctl_1, 0x9f);
	return rc;
}

int cs4x_pause(struct cs4x_drv *dac) {
	// Mute the output
	int rc = cs4x_mute_on(dac);
	// Put the Codec in Power save mode
	rc |= cs4x_wr(dac, CS43L22_REG_Power_Ctl_1, 0x01);
	return rc;
}

int cs4x_resume(struct cs4x_drv *dac) {
	// Unmute the output
	int rc = cs4x_mute_off(dac);
	// Power on the Codec
	rc |= cs4x_wr(dac, CS43L22_REG_Power_Ctl_1, 0x9e);
	return rc;
}
/* USER CODE END 0 */

/**
  * @brief  The application entry point.
  * @retval int
  */
int main(void)
{

  /* USER CODE BEGIN 1 */

  /* USER CODE END 1 */

  /* MCU Configuration--------------------------------------------------------*/

  /* Reset of all peripherals, Initializes the Flash interface and the Systick. */
  HAL_Init();

  /* USER CODE BEGIN Init */
	uint8_t buf[12];

  /* USER CODE END Init */

  /* Configure the system clock */
  SystemClock_Config();

  /* USER CODE BEGIN SysInit */

  /* USER CODE END SysInit */

  /* Initialize all configured peripherals */
  MX_GPIO_Init();
  MX_DMA_Init();
  MX_I2C1_Init();
  MX_I2S3_Init();
  MX_SPI1_Init();
  MX_USB_OTG_FS_PCD_Init();
  MX_ADC1_Init();
  /* USER CODE BEGIN 2 */
  // Lookup table population
  populate_ADR_tables();

	// EXT DAC INTIIALIZATION
	struct cs4x_cfg cfgdac;
	cfgdac.adr = DACADDR;
	cfgdac.out = DAC_OUTPUT_HEADPHONE;
	struct cs4x_drv dac;
	int rc = cs4x_init(&dac, &cfgdac);
	printf("CS4X init returned %d\r\n", rc);
	rc = cs4x_start(&dac);
	printf("CS4X start returned %d\r\n", rc);

	HAL_Delay(1);

	HAL_StatusTypeDef res;

	// Attempt to transmit audio data to DAC
	processData();
	outBufPtr = &dacData[BUFFER_SIZE/2];
	processData();
	//outBufPtr = &dacData[BUFFER_SIZE / 2];
	//processData();
	res = HAL_I2S_Transmit_DMA(&hi2s3, (uint16_t*) dacData, BUFFER_SIZE);
	//res = HAL_I2S_Transmit(&hi2s3, (uint16_t*) signal, nsamples,HAL_MAX_DELAY);
	if (res != HAL_OK) {
		printf("I2S - ERROR, res = %d!\r\n", res);
	}
	printf("loops after first two processes: %ld\r\n", (long)loops);

  /* USER CODE END 2 */

  /* Infinite loop */
  /* USER CODE BEGIN WHILE */
	while (1) {
    /* USER CODE END WHILE */

    /* USER CODE BEGIN 3 */
		if (dataReadyFlag) {
			if (! (loops % 2000)) { //was 2000
				//TODO move this to within the processData call
				HAL_ADC_Start_DMA(&hadc1, (uint32_t *) AD_RES_BUFFER, 3);
			}
			processData();
		}


	}

  /* USER CODE END 3 */
}

/**
  * @brief System Clock Configuration
  * @retval None
  */
void SystemClock_Config(void)
{
  RCC_OscInitTypeDef RCC_OscInitStruct = {0};
  RCC_ClkInitTypeDef RCC_ClkInitStruct = {0};

  /** Configure the main internal regulator output voltage
  */
  __HAL_RCC_PWR_CLK_ENABLE();
  __HAL_PWR_VOLTAGESCALING_CONFIG(PWR_REGULATOR_VOLTAGE_SCALE1);

  /** Initializes the RCC Oscillators according to the specified parameters
  * in the RCC_OscInitTypeDef structure.
  */
  RCC_OscInitStruct.OscillatorType = RCC_OSCILLATORTYPE_HSE;
  RCC_OscInitStruct.HSEState = RCC_HSE_ON;
  RCC_OscInitStruct.PLL.PLLState = RCC_PLL_ON;
  RCC_OscInitStruct.PLL.PLLSource = RCC_PLLSOURCE_HSE;
  RCC_OscInitStruct.PLL.PLLM = 8;
  RCC_OscInitStruct.PLL.PLLN = 336;
  RCC_OscInitStruct.PLL.PLLP = RCC_PLLP_DIV2;
  RCC_OscInitStruct.PLL.PLLQ = 7;
  if (HAL_RCC_OscConfig(&RCC_OscInitStruct) != HAL_OK)
  {
    Error_Handler();
  }

  /** Initializes the CPU, AHB and APB buses clocks
  */
  RCC_ClkInitStruct.ClockType = RCC_CLOCKTYPE_HCLK|RCC_CLOCKTYPE_SYSCLK
                              |RCC_CLOCKTYPE_PCLK1|RCC_CLOCKTYPE_PCLK2;
  RCC_ClkInitStruct.SYSCLKSource = RCC_SYSCLKSOURCE_PLLCLK;
  RCC_ClkInitStruct.AHBCLKDivider = RCC_SYSCLK_DIV1;
  RCC_ClkInitStruct.APB1CLKDivider = RCC_HCLK_DIV4;
  RCC_ClkInitStruct.APB2CLKDivider = RCC_HCLK_DIV2;

  if (HAL_RCC_ClockConfig(&RCC_ClkInitStruct, FLASH_LATENCY_5) != HAL_OK)
  {
    Error_Handler();
  }
}

/**
  * @brief ADC1 Initialization Function
  * @param None
  * @retval None
  */
static void MX_ADC1_Init(void)
{

  /* USER CODE BEGIN ADC1_Init 0 */

  /* USER CODE END ADC1_Init 0 */

  ADC_ChannelConfTypeDef sConfig = {0};

  /* USER CODE BEGIN ADC1_Init 1 */

  /* USER CODE END ADC1_Init 1 */

  /** Configure the global features of the ADC (Clock, Resolution, Data Alignment and number of conversion)
  */
  hadc1.Instance = ADC1;
  hadc1.Init.ClockPrescaler = ADC_CLOCK_SYNC_PCLK_DIV4;
  hadc1.Init.Resolution = ADC_RESOLUTION_8B;
  hadc1.Init.ScanConvMode = ENABLE;
  hadc1.Init.ContinuousConvMode = DISABLE;
  hadc1.Init.DiscontinuousConvMode = DISABLE;
  hadc1.Init.ExternalTrigConvEdge = ADC_EXTERNALTRIGCONVEDGE_NONE;
  hadc1.Init.ExternalTrigConv = ADC_SOFTWARE_START;
  hadc1.Init.DataAlign = ADC_DATAALIGN_RIGHT;
  hadc1.Init.NbrOfConversion = 3;
  hadc1.Init.DMAContinuousRequests = DISABLE;
  hadc1.Init.EOCSelection = ADC_EOC_SINGLE_CONV;
  if (HAL_ADC_Init(&hadc1) != HAL_OK)
  {
    Error_Handler();
  }

  /** Configure for the selected ADC regular channel its corresponding rank in the sequencer and its sample time.
  */
  sConfig.Channel = ADC_CHANNEL_1;
  sConfig.Rank = 1;
  sConfig.SamplingTime = ADC_SAMPLETIME_84CYCLES;
  if (HAL_ADC_ConfigChannel(&hadc1, &sConfig) != HAL_OK)
  {
    Error_Handler();
  }

  /** Configure for the selected ADC regular channel its corresponding rank in the sequencer and its sample time.
  */
  sConfig.Channel = ADC_CHANNEL_3;
  sConfig.Rank = 2;
  if (HAL_ADC_ConfigChannel(&hadc1, &sConfig) != HAL_OK)
  {
    Error_Handler();
  }

  /** Configure for the selected ADC regular channel its corresponding rank in the sequencer and its sample time.
  */
  sConfig.Channel = ADC_CHANNEL_11;
  sConfig.Rank = 3;
  if (HAL_ADC_ConfigChannel(&hadc1, &sConfig) != HAL_OK)
  {
    Error_Handler();
  }
  /* USER CODE BEGIN ADC1_Init 2 */

  /* USER CODE END ADC1_Init 2 */

}

/**
  * @brief I2C1 Initialization Function
  * @param None
  * @retval None
  */
static void MX_I2C1_Init(void)
{

  /* USER CODE BEGIN I2C1_Init 0 */

  /* USER CODE END I2C1_Init 0 */

  /* USER CODE BEGIN I2C1_Init 1 */

  /* USER CODE END I2C1_Init 1 */
  hi2c1.Instance = I2C1;
  hi2c1.Init.ClockSpeed = 100000;
  hi2c1.Init.DutyCycle = I2C_DUTYCYCLE_2;
  hi2c1.Init.OwnAddress1 = 0;
  hi2c1.Init.AddressingMode = I2C_ADDRESSINGMODE_7BIT;
  hi2c1.Init.DualAddressMode = I2C_DUALADDRESS_DISABLE;
  hi2c1.Init.OwnAddress2 = 0;
  hi2c1.Init.GeneralCallMode = I2C_GENERALCALL_DISABLE;
  hi2c1.Init.NoStretchMode = I2C_NOSTRETCH_DISABLE;
  if (HAL_I2C_Init(&hi2c1) != HAL_OK)
  {
    Error_Handler();
  }
  /* USER CODE BEGIN I2C1_Init 2 */

  /* USER CODE END I2C1_Init 2 */

}

/**
  * @brief I2S3 Initialization Function
  * @param None
  * @retval None
  */
static void MX_I2S3_Init(void)
{

  /* USER CODE BEGIN I2S3_Init 0 */

  /* USER CODE END I2S3_Init 0 */

  /* USER CODE BEGIN I2S3_Init 1 */

  /* USER CODE END I2S3_Init 1 */
  hi2s3.Instance = SPI3;
  hi2s3.Init.Mode = I2S_MODE_MASTER_TX;
  hi2s3.Init.Standard = I2S_STANDARD_PHILIPS;
  hi2s3.Init.DataFormat = I2S_DATAFORMAT_16B;
  hi2s3.Init.MCLKOutput = I2S_MCLKOUTPUT_ENABLE;
  hi2s3.Init.AudioFreq = I2S_AUDIOFREQ_48K;
  hi2s3.Init.CPOL = I2S_CPOL_LOW;
  hi2s3.Init.ClockSource = I2S_CLOCK_PLL;
  hi2s3.Init.FullDuplexMode = I2S_FULLDUPLEXMODE_DISABLE;
  if (HAL_I2S_Init(&hi2s3) != HAL_OK)
  {
    Error_Handler();
  }
  /* USER CODE BEGIN I2S3_Init 2 */

  /* USER CODE END I2S3_Init 2 */

}

/**
  * @brief SPI1 Initialization Function
  * @param None
  * @retval None
  */
static void MX_SPI1_Init(void)
{

  /* USER CODE BEGIN SPI1_Init 0 */

  /* USER CODE END SPI1_Init 0 */

  /* USER CODE BEGIN SPI1_Init 1 */

  /* USER CODE END SPI1_Init 1 */
  /* SPI1 parameter configuration*/
  hspi1.Instance = SPI1;
  hspi1.Init.Mode = SPI_MODE_MASTER;
  hspi1.Init.Direction = SPI_DIRECTION_2LINES;
  hspi1.Init.DataSize = SPI_DATASIZE_8BIT;
  hspi1.Init.CLKPolarity = SPI_POLARITY_LOW;
  hspi1.Init.CLKPhase = SPI_PHASE_1EDGE;
  hspi1.Init.NSS = SPI_NSS_SOFT;
  hspi1.Init.BaudRatePrescaler = SPI_BAUDRATEPRESCALER_2;
  hspi1.Init.FirstBit = SPI_FIRSTBIT_MSB;
  hspi1.Init.TIMode = SPI_TIMODE_DISABLE;
  hspi1.Init.CRCCalculation = SPI_CRCCALCULATION_DISABLE;
  hspi1.Init.CRCPolynomial = 10;
  if (HAL_SPI_Init(&hspi1) != HAL_OK)
  {
    Error_Handler();
  }
  /* USER CODE BEGIN SPI1_Init 2 */

  /* USER CODE END SPI1_Init 2 */

}

/**
  * @brief USB_OTG_FS Initialization Function
  * @param None
  * @retval None
  */
static void MX_USB_OTG_FS_PCD_Init(void)
{

  /* USER CODE BEGIN USB_OTG_FS_Init 0 */

  /* USER CODE END USB_OTG_FS_Init 0 */

  /* USER CODE BEGIN USB_OTG_FS_Init 1 */

  /* USER CODE END USB_OTG_FS_Init 1 */
  hpcd_USB_OTG_FS.Instance = USB_OTG_FS;
  hpcd_USB_OTG_FS.Init.dev_endpoints = 4;
  hpcd_USB_OTG_FS.Init.speed = PCD_SPEED_FULL;
  hpcd_USB_OTG_FS.Init.dma_enable = DISABLE;
  hpcd_USB_OTG_FS.Init.phy_itface = PCD_PHY_EMBEDDED;
  hpcd_USB_OTG_FS.Init.Sof_enable = DISABLE;
  hpcd_USB_OTG_FS.Init.low_power_enable = DISABLE;
  hpcd_USB_OTG_FS.Init.lpm_enable = DISABLE;
  hpcd_USB_OTG_FS.Init.vbus_sensing_enable = ENABLE;
  hpcd_USB_OTG_FS.Init.use_dedicated_ep1 = DISABLE;
  if (HAL_PCD_Init(&hpcd_USB_OTG_FS) != HAL_OK)
  {
    Error_Handler();
  }
  /* USER CODE BEGIN USB_OTG_FS_Init 2 */

  /* USER CODE END USB_OTG_FS_Init 2 */

}

/**
  * Enable DMA controller clock
  */
static void MX_DMA_Init(void)
{

  /* DMA controller clock enable */
  __HAL_RCC_DMA1_CLK_ENABLE();
  __HAL_RCC_DMA2_CLK_ENABLE();

  /* DMA interrupt init */
  /* DMA1_Stream5_IRQn interrupt configuration */
  HAL_NVIC_SetPriority(DMA1_Stream5_IRQn, 0, 0);
  HAL_NVIC_EnableIRQ(DMA1_Stream5_IRQn);
  /* DMA2_Stream0_IRQn interrupt configuration */
  HAL_NVIC_SetPriority(DMA2_Stream0_IRQn, 0, 0);
  HAL_NVIC_EnableIRQ(DMA2_Stream0_IRQn);

}

/**
  * @brief GPIO Initialization Function
  * @param None
  * @retval None
  */
static void MX_GPIO_Init(void)
{
  GPIO_InitTypeDef GPIO_InitStruct = {0};
  /* USER CODE BEGIN MX_GPIO_Init_1 */

  /* USER CODE END MX_GPIO_Init_1 */

  /* GPIO Ports Clock Enable */
  __HAL_RCC_GPIOE_CLK_ENABLE();
  __HAL_RCC_GPIOC_CLK_ENABLE();
  __HAL_RCC_GPIOH_CLK_ENABLE();
  __HAL_RCC_GPIOA_CLK_ENABLE();
  __HAL_RCC_GPIOB_CLK_ENABLE();
  __HAL_RCC_GPIOD_CLK_ENABLE();

  /*Configure GPIO pin Output Level */
  HAL_GPIO_WritePin(CS_I2C_SPI_GPIO_Port, CS_I2C_SPI_Pin, GPIO_PIN_RESET);

  /*Configure GPIO pin Output Level */
  HAL_GPIO_WritePin(OTG_FS_PowerSwitchOn_GPIO_Port, OTG_FS_PowerSwitchOn_Pin, GPIO_PIN_SET);

  /*Configure GPIO pin Output Level */
  HAL_GPIO_WritePin(GPIOD, LD4_Pin|LD3_Pin|LD5_Pin|LD6_Pin
                          |Audio_RST_Pin, GPIO_PIN_RESET);

  /*Configure GPIO pin : CS_I2C_SPI_Pin */
  GPIO_InitStruct.Pin = CS_I2C_SPI_Pin;
  GPIO_InitStruct.Mode = GPIO_MODE_OUTPUT_PP;
  GPIO_InitStruct.Pull = GPIO_NOPULL;
  GPIO_InitStruct.Speed = GPIO_SPEED_FREQ_LOW;
  HAL_GPIO_Init(CS_I2C_SPI_GPIO_Port, &GPIO_InitStruct);

  /*Configure GPIO pin : OTG_FS_PowerSwitchOn_Pin */
  GPIO_InitStruct.Pin = OTG_FS_PowerSwitchOn_Pin;
  GPIO_InitStruct.Mode = GPIO_MODE_OUTPUT_PP;
  GPIO_InitStruct.Pull = GPIO_NOPULL;
  GPIO_InitStruct.Speed = GPIO_SPEED_FREQ_LOW;
  HAL_GPIO_Init(OTG_FS_PowerSwitchOn_GPIO_Port, &GPIO_InitStruct);

  /*Configure GPIO pin : PDM_OUT_Pin */
  GPIO_InitStruct.Pin = PDM_OUT_Pin;
  GPIO_InitStruct.Mode = GPIO_MODE_AF_PP;
  GPIO_InitStruct.Pull = GPIO_NOPULL;
  GPIO_InitStruct.Speed = GPIO_SPEED_FREQ_LOW;
  GPIO_InitStruct.Alternate = GPIO_AF5_SPI2;
  HAL_GPIO_Init(PDM_OUT_GPIO_Port, &GPIO_InitStruct);

  /*Configure GPIO pin : B1_Pin */
  GPIO_InitStruct.Pin = B1_Pin;
  GPIO_InitStruct.Mode = GPIO_MODE_EVT_RISING;
  GPIO_InitStruct.Pull = GPIO_NOPULL;
  HAL_GPIO_Init(B1_GPIO_Port, &GPIO_InitStruct);

  /*Configure GPIO pin : BOOT1_Pin */
  GPIO_InitStruct.Pin = BOOT1_Pin;
  GPIO_InitStruct.Mode = GPIO_MODE_INPUT;
  GPIO_InitStruct.Pull = GPIO_NOPULL;
  HAL_GPIO_Init(BOOT1_GPIO_Port, &GPIO_InitStruct);

  /*Configure GPIO pin : CLK_IN_Pin */
  GPIO_InitStruct.Pin = CLK_IN_Pin;
  GPIO_InitStruct.Mode = GPIO_MODE_AF_PP;
  GPIO_InitStruct.Pull = GPIO_NOPULL;
  GPIO_InitStruct.Speed = GPIO_SPEED_FREQ_LOW;
  GPIO_InitStruct.Alternate = GPIO_AF5_SPI2;
  HAL_GPIO_Init(CLK_IN_GPIO_Port, &GPIO_InitStruct);

  /*Configure GPIO pins : LD4_Pin LD3_Pin LD5_Pin LD6_Pin */
  GPIO_InitStruct.Pin = LD4_Pin|LD3_Pin|LD5_Pin|LD6_Pin;
  GPIO_InitStruct.Mode = GPIO_MODE_OUTPUT_PP;
  GPIO_InitStruct.Pull = GPIO_NOPULL;
  GPIO_InitStruct.Speed = GPIO_SPEED_FREQ_LOW;
  HAL_GPIO_Init(GPIOD, &GPIO_InitStruct);

  /*Configure GPIO pin : Audio_RST_Pin */
  GPIO_InitStruct.Pin = Audio_RST_Pin;
  GPIO_InitStruct.Mode = GPIO_MODE_OUTPUT_PP;
  GPIO_InitStruct.Pull = GPIO_PULLUP;
  GPIO_InitStruct.Speed = GPIO_SPEED_FREQ_LOW;
  HAL_GPIO_Init(Audio_RST_GPIO_Port, &GPIO_InitStruct);

  /*Configure GPIO pin : OTG_FS_OverCurrent_Pin */
  GPIO_InitStruct.Pin = OTG_FS_OverCurrent_Pin;
  GPIO_InitStruct.Mode = GPIO_MODE_INPUT;
  GPIO_InitStruct.Pull = GPIO_NOPULL;
  HAL_GPIO_Init(OTG_FS_OverCurrent_GPIO_Port, &GPIO_InitStruct);

  /*Configure GPIO pin : MEMS_INT2_Pin */
  GPIO_InitStruct.Pin = MEMS_INT2_Pin;
  GPIO_InitStruct.Mode = GPIO_MODE_EVT_RISING;
  GPIO_InitStruct.Pull = GPIO_NOPULL;
  HAL_GPIO_Init(MEMS_INT2_GPIO_Port, &GPIO_InitStruct);

  /* USER CODE BEGIN MX_GPIO_Init_2 */

  /* USER CODE END MX_GPIO_Init_2 */
}

/* USER CODE BEGIN 4 */
int _write(int file, char *ptr, int len) {
	(void) file;
	int DataIdx;

	for (DataIdx = 0; DataIdx < len; DataIdx++) {
		ITM_SendChar(*ptr++);
	}
	return len;
}
/* USER CODE END 4 */

/**
  * @brief  This function is executed in case of error occurrence.
  * @retval None
  */
void Error_Handler(void)
{
  /* USER CODE BEGIN Error_Handler_Debug */
	/* User can add his own implementation to report the HAL error return state */
	__disable_irq();
	while (1) {
		printf("Error\r\n");
	}
  /* USER CODE END Error_Handler_Debug */
}

#ifdef  USE_FULL_ASSERT
/**
  * @brief  Reports the name of the source file and the source line number
  *         where the assert_param error has occurred.
  * @param  file: pointer to the source file name
  * @param  line: assert_param error line source number
  * @retval None
  */
void assert_failed(uint8_t *file, uint32_t line)
{
  /* USER CODE BEGIN 6 */
	/* User can add his own implementation to report the file name and line number,
     ex: printf("Wrong parameters value: file %s on line %d\r\n", file, line) */
  /* USER CODE END 6 */
}
#endif /* USE_FULL_ASSERT */
