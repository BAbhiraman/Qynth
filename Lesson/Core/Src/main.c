/* USER CODE BEGIN Header */
/**
 ******************************************************************************
 * @file           : main.c
 * @brief          : Main program body
 ******************************************************************************
 * @attention
 *
 * Copyright (c) 2025 STMicroelectronics.
 * All rights reserved.
 *
 * This software is licensed under terms that can be found in the LICENSE file
 * in the root directory of this software component.
 * If no LICENSE file comes with this software, it is provided AS-IS.
 *
 *SWO print tutorial: https://youtu.be/iR34qmfyZtU?si=ymslVCKYRUU1sUiR
 *
 ******************************************************************************
 */
/* USER CODE END Header */
/* Includes ------------------------------------------------------------------*/
#include "main.h"

/* Private includes ----------------------------------------------------------*/
/* USER CODE BEGIN Includes */
#include <math.h>
#include <stdio.h>

/* USER CODE END Includes */

/* Private typedef -----------------------------------------------------------*/
/* USER CODE BEGIN PTD */

/* USER CODE END PTD */

/* Private define ------------------------------------------------------------*/
/* USER CODE BEGIN PD */
#define PI 3.1415926535897932384626433832795028841971693993751058209749445923078164062862089986280348253421170679
#define TAU (2.0 * PI)
#define BUFFER_SIZE 128 //Phil's lab used 128. 48000 working.
#define INT16_TO_FLOAT 1.0f/(32767.0f)
#define FLOAT_TO_INT16 32767.0f
#define FS 32063.0f //see IOC see for 48 kHz inaccuracy WAS 48000
#define TS 1.0f/(float)FS
#define SINE_LOOKUP_SIZE 4096

// DAC PARAMS
#define DACADDR 0x94
#define CS43L22_REG_ID                              0x01
#define CS43L22_REG_Power_Ctl_1                     0x02
#define CS43L22_REG_Power_Ctl_2                     0x04
#define CS43L22_REG_Clocking_Ctl                    0x05
#define CS43L22_REG_Interface_Ctl_1                 0x06
#define CS43L22_REG_Interface_Ctl_2                 0x07
#define CS43L22_REG_Passthrough_A_Select            0x08
#define CS43L22_REG_Passthrough_B_Select            0x09
#define CS43L22_REG_Analog_ZC_and_SR_Settings       0x0A
#define CS43L22_REG_Passthrough_Gang_Control        0x0C
#define CS43L22_REG_Playback_Ctl_1                  0x0D
#define CS43L22_REG_Misc_Ctl                        0x0E
#define CS43L22_REG_Playback_Ctl_2                  0x0F
#define CS43L22_REG_Passthrough_A_Vol               0x14
#define CS43L22_REG_Passthrough_B_Vol               0x15
#define CS43L22_REG_PCMA_Vol                        0x1A
#define CS43L22_REG_PCMB_Vol                        0x1B
#define CS43L22_REG_BEEP_Freq_On_Time               0x1C
#define CS43L22_REG_BEEP_Vol_Off_Time               0x1D
#define CS43L22_REG_BEEP_Tone_Cfg                   0x1E
#define CS43L22_REG_Tone_Ctl                        0x1F
#define CS43L22_REG_Master_A_Vol                    0x20
#define CS43L22_REG_Master_B_Vol                    0x21
#define CS43L22_REG_Headphone_A_Volume              0x22
#define CS43L22_REG_Headphone_B_Volume              0x23
#define CS43L22_REG_Speaker_A_Volume                0x24
#define CS43L22_REG_Speaker_B_Volume                0x25
#define CS43L22_REG_Channel_Mixer_Swap              0x26
#define CS43L22_REG_Limit_Ctl_1_Thresholds          0x27
#define CS43L22_REG_Limit_Ctl_2_Release_Rate        0x28
#define CS43L22_REG_Limiter_Attack_Rate             0x29
#define CS43L22_REG_Overflow_Clock_Status           0x2E
#define CS43L22_REG_Battery_Compensation            0x2F
#define CS43L22_REG_VP_Battery_Level                0x30
#define CS43L22_REG_Speaker_Status                  0x31
#define CS43L22_REG_Charge_Pump_Frequency           0x34

/* USER CODE END PD */

/* Private macro -------------------------------------------------------------*/
/* USER CODE BEGIN PM */

/* USER CODE END PM */

/* Private variables ---------------------------------------------------------*/
ADC_HandleTypeDef hadc1;
DMA_HandleTypeDef hdma_adc1;

I2C_HandleTypeDef hi2c1;

I2S_HandleTypeDef hi2s3;
DMA_HandleTypeDef hdma_spi3_tx;

SPI_HandleTypeDef hspi1;

UART_HandleTypeDef huart2;
DMA_HandleTypeDef hdma_usart2_rx;

PCD_HandleTypeDef hpcd_USB_OTG_FS;

/* USER CODE BEGIN PV */
int16_t dac_data[BUFFER_SIZE];

static volatile int16_t *outBufPtr = &dac_data[0];
volatile uint8_t data_ready_flag = 0; // added this = 0
volatile uint8_t write_first_half = 0;
volatile uint64_t ticks = 0; //number of samples output
volatile uint64_t loops = 0;
// Can use this nice ode to joy with bassline if you don't have keyboard input yet
int8_t ode_to_joy[] =  {4,4,5,7,7,5,4,2,0,0,2,4,4,4,2,2,4,4,5,7,7,5,4,2,0,0,2,4,2,2,0,0};
int8_t ode_to_joy2[] = {0, -5, -3, -1, -5, -3, -4, -1, -3, -4, -5, -6, -10, -6, -5, -1, 0, -5, -3, -1, -5, -3, -4, -1, -3, -4, -10, -6, -7, -5, -8, -12};
uint8_t len_joy = sizeof(ode_to_joy);

const int16_t sine_table[] = {
0, 50, 101, 151, 201, 251, 302, 352, 402, 452, 503, 553,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 18826,
18868, 18909, 18950, 18991, 19032, 19072, 19113, 19154, 19195, 19236, 19276, 19317,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 30835,
30852, 30868, 30885, 30902, 30919, 30935, 30952, 30968, 30985, 31001, 31017, 31033,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 31593,
31580, 31567, 31553, 31539, 31526, 31512, 31498, 31484, 31470, 31456, 31442, 31428,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 20826,
20787, 20748, 20709, 20670, 20631, 20592, 20553, 20514, 20475, 20436, 20396, 20357,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 2461,
2410, 2360, 2310, 2260, 2210, 2160, 2110, 2059, 2009, 1959, 1909, 1859,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 -16802,
-16846, -16889, -16932, -16975, -17018, -17061, -17104, -17146, -17189, -17232, -17275, -17317,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 -29936,
-29956, -29976, -29997, -30017, -30037, -30057, -30077, -30097, -30117, -30136, -30156, -30176,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 -32147,
-32137, -32128, -32118, -32108, -32098, -32087, -32077, -32067, -32057, -32046, -32036, -32025,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 -22631,
-22594, -22558, -22521, -22485, -22448, -22411, -22375, -22338, -22301, -22264, -22227, -22191,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 -4858,
-4808, -4758, -4708, -4659, -4609, -4559, -4509, -4460, -4410, -4360, -4310, -4260,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 -101, -50};
/* USER CODE END PV */

/* Private function prototypes -----------------------------------------------*/
void SystemClock_Config(void);
static void MX_GPIO_Init(void);
static void MX_DMA_Init(void);
static void MX_I2C1_Init(void);
static void MX_I2S3_Init(void);
static void MX_SPI1_Init(void);
static void MX_USB_OTG_FS_PCD_Init(void);
static void MX_ADC1_Init(void);
static void MX_USART2_UART_Init(void);
/* USER CODE BEGIN PFP */

/* USER CODE END PFP */

/* Private user code ---------------------------------------------------------*/
/* USER CODE BEGIN 0 */
void HAL_I2S_TxHalfCpltCallback(I2S_HandleTypeDef *hi2s) {
	HAL_GPIO_TogglePin(GPIOD, LD4_Pin); //green
	outBufPtr = &dac_data[0];
	data_ready_flag = 1;
	//processData(1);
}

void HAL_I2S_TxCpltCallback(I2S_HandleTypeDef *hi2s) {
	HAL_GPIO_TogglePin(GPIOD, LD3_Pin);
	outBufPtr = &dac_data[BUFFER_SIZE / 2];
	data_ready_flag = 1;
	//processData(0);
}

void processData() {
	//navflag
	if (outBufPtr == &dac_data[0]) {
		HAL_GPIO_WritePin(GPIOD, LD6_Pin, GPIO_PIN_SET); //blue
	}
	else {
		HAL_GPIO_WritePin(GPIOD, LD5_Pin, GPIO_PIN_SET); //red
	}
	//static float leftOut, rightOut;
	static int16_t leftOutInt, rightOutInt;
	float t;
	float f, f2;
	//double phase;
	uint16_t phase, phase2 = 0;
	uint16_t M = BUFFER_SIZE/4;
	uint8_t noteInd = ((uint8_t)(loops/256)) % len_joy;
	//printf("%u\r\n",noteInd);
	f = 440.0f*pow(1.0594630943592952646f,ode_to_joy[noteInd]); //1.06 is root 12.
	f2 = 440.0f*pow(1.0594630943592952646f,ode_to_joy2[noteInd]);
	//printf("%d \r\n", odeToJoy[noteInd])
	for (uint16_t n = 0; n < (BUFFER_SIZE / 2) - 1; n += 2) {

		t = (ticks) * TS;
		//f = 440;
		leftOutInt = 0;
		phase  = ((uint16_t)(SINE_LOOKUP_SIZE *f * t)) & (SINE_LOOKUP_SIZE-1);
		phase2 = ((uint16_t)(SINE_LOOKUP_SIZE *f2* t)) & (SINE_LOOKUP_SIZE-1);
		//tglobal += 1.0/FS;
		//leftOut = (float)sin(phase);
		leftOutInt = 0.3f*(float)sine_table[phase] + 0.3f*(float)sine_table[phase2];

		//rightOut = leftOut;
		outBufPtr[n] = (int16_t)leftOutInt; //(10000 * leftOut); //15k worked, 25k worked, 30k worked, 32767 worked, 32768 OVERFLOWs andcr
		outBufPtr[n + 1] = (int16_t)leftOutInt; //(10000 * rightOut);
		ticks++;

	}
	loops++;
//	printf("\r\n");
	data_ready_flag = 0;
	HAL_GPIO_WritePin(GPIOD, LD6_Pin, GPIO_PIN_RESET); //blue
	HAL_GPIO_WritePin(GPIOD, LD5_Pin, GPIO_PIN_RESET); //red

}

// CS43L22 Stereo DAC driver by https://github.com/deadsy/googoomuck/blob/master/drivers/cs43l22.h
enum {
	DAC_OUTPUT_OFF,		// must be 0
	DAC_OUTPUT_SPEAKER,
	DAC_OUTPUT_HEADPHONE,
	DAC_OUTPUT_BOTH,
	DAC_OUTPUT_AUTO,
	DAC_OUTPUT_MAX,		// must be last
};

struct cs4x_cfg {
	//struct i2c_drv *i2c;	// i2c bus
	uint8_t adr;		// device i2c bus address
	//int rst;		// gpio for reset pin
	int out;		// output device
};

struct cs4x_drv {
	struct cs4x_cfg cfg;
};

HAL_StatusTypeDef i2c_wr(uint8_t *buf, uint8_t Nbytes) {
	HAL_StatusTypeDef rc;
	rc = HAL_I2C_Master_Transmit(&hi2c1, DACADDR, buf, Nbytes, HAL_MAX_DELAY);
	return rc;
}

HAL_StatusTypeDef i2c_rd(uint8_t *buf, uint8_t Nbytes) {
	HAL_StatusTypeDef rc;
	rc = HAL_I2C_Master_Receive(&hi2c1, DACADDR, buf, Nbytes, HAL_MAX_DELAY);
	return rc;
}
// read a dac register
static int cs4x_rd(struct cs4x_drv *dac, uint8_t reg, uint8_t *val) {
	uint8_t buf[1] = { reg };
	int rc;
	rc = i2c_wr(buf, 1);
	if (rc != 0) {
		return rc;
	}
	rc = i2c_rd(buf, 1);
	if (rc != 0) {
		return rc;
	}
	*val = buf[0];
	return 0;
}

// write a dac register
static int cs4x_wr(struct cs4x_drv *dac, uint8_t reg, uint8_t val) {
	uint8_t buf[2] = { reg, val };
	return i2c_wr(buf, 2);
}

// read/modify/write a register
static int cs4x_rmw(struct cs4x_drv *dac, uint8_t reg, uint8_t mask,
		uint8_t val) {
	uint8_t x;
	int rc;
	rc = cs4x_rd(dac, reg, &x);
	if (rc != 0) {
		return rc;
	}
	x &= ~mask;
	x |= val & mask;
	return cs4x_wr(dac, reg, x);
}

// set bits in a register
static int cs4x_set(struct cs4x_drv *dac, uint8_t reg, uint8_t bits) {
	return cs4x_rmw(dac, reg, bits, 0xff);
}

// clear bits in a register
static int cs4x_clr(struct cs4x_drv *dac, uint8_t reg, uint8_t bits) {
	return cs4x_rmw(dac, reg, bits, 0);
}

//-----------------------------------------------------------------------------

// read and verify the device id
static int cs4x_id(struct cs4x_drv *dac) {
	uint8_t id;
	int rc;
	rc = cs4x_rd(dac, CS43L22_REG_ID, &id);
	if (rc != 0) {
		return rc;
	}
	if ((id & 0xf8) != 0xe0) {
		return -1;
	}
	return 0;
}

//-----------------------------------------------------------------------------

// set the output device
int cs4x_output(struct cs4x_drv *dac, unsigned int out) {
	const uint8_t ctrl[DAC_OUTPUT_MAX] = { 0xff, 0xfa, 0xaf, 0xaa, 0x05 };
	int rc;
	if (out >= DAC_OUTPUT_MAX) {
		out = DAC_OUTPUT_OFF;
	}
	rc = cs4x_wr(dac, CS43L22_REG_Power_Ctl_2, ctrl[out]);
	if (rc != 0) {
		return rc;
	}
	dac->cfg.out = out;
	return 0;
}

//-----------------------------------------------------------------------------
// volume controls
// Map 0..255 to the control value for a volume register.
// 0 is minium volume (or mute), 255 is maximum volume.

// set the master volume
int cs4x_master_volume(struct cs4x_drv *dac, uint8_t vol) {
	uint32_t x;
	int rc;
	x = (((281 - 52) << 16) / 255) * vol + (52 << 16);
	x >>= 16;
	x &= 255;
	rc = cs4x_wr(dac, CS43L22_REG_Master_A_Vol, x);
	rc |= cs4x_wr(dac, CS43L22_REG_Master_B_Vol, x);
	return rc;
}

// set the headphone volume
int cs4x_headphone_volume(struct cs4x_drv *dac, uint8_t vol) {
	uint32_t x;
	int rc;
	if (vol == 0) {
		x = 1;		// muted
	} else {
		x = (((257 - 52) << 16) / 255) * (vol - 1) + (52 << 16);
		x >>= 16;
		x &= 255;
	}
	rc = cs4x_wr(dac, CS43L22_REG_Headphone_A_Volume, x);
	rc |= cs4x_wr(dac, CS43L22_REG_Headphone_B_Volume, x);
	return rc;
}

// set the speaker volume
int cs4x_speaker_volume(struct cs4x_drv *dac, uint8_t vol) {
	uint32_t x;
	int rc;
	if (vol == 0) {
		x = 1;		// muted
	} else {
		x = (((257 - 64) << 16) / 255) * (vol - 1) + (64 << 16);
		x >>= 16;
		x &= 255;
	}
	rc = cs4x_wr(dac, CS43L22_REG_Speaker_A_Volume, x);
	rc |= cs4x_wr(dac, CS43L22_REG_Speaker_B_Volume, x);
	return rc;
}

// set the pcm volume
int cs4x_pcm_volume(struct cs4x_drv *dac, uint8_t vol) {
	uint32_t x;
	int rc;
	if (vol == 0) {
		x = 0x80;	// muted
	} else {
		x = (((281 - 25) << 16) / (255 - 1)) * (vol - 1) + (25 << 16);
		x >>= 16;
		x &= 255;
	}
	rc = cs4x_wr(dac, CS43L22_REG_PCMA_Vol, x);
	rc |= cs4x_wr(dac, CS43L22_REG_PCMB_Vol, x);
	return rc;
}

//-----------------------------------------------------------------------------
// mute on/off

static int cs4x_mute_on(struct cs4x_drv *dac) {
	int rc = cs4x_wr(dac, CS43L22_REG_Power_Ctl_2, 0xff);
	rc |= cs4x_headphone_volume(dac, 0);
	return rc;
}

static int cs4x_mute_off(struct cs4x_drv *dac) {
	int rc = cs4x_headphone_volume(dac, 0xff);
	rc |= cs4x_output(dac, dac->cfg.out);
	return rc;
}

//-----------------------------------------------------------------------------

int cs4x_init(struct cs4x_drv *dac, struct cs4x_cfg *cfg) {
	int rc;

	memset(dac, 0, sizeof(struct cs4x_drv));
	dac->cfg = *cfg;

	// 4.9 Recommended Power-Up Sequence (1,2)
	// reset the dac
	// DAC Reset is active low, so pull the pin high.
	HAL_GPIO_WritePin(Audio_RST_GPIO_Port, Audio_RST_Pin, GPIO_PIN_RESET);
	HAL_GPIO_WritePin(Audio_RST_GPIO_Port, Audio_RST_Pin, GPIO_PIN_SET);

	rc = cs4x_id(dac);
	if (rc != 0) {
		printf("cs4x bad device id %d\r\n", rc);
		goto exit;
	}
	// 4.9 Recommended Power-Up Sequence (4)
	// 4.11 Required Initialization Settings
	rc |= cs4x_wr(dac, 0, 0x99);
	rc |= cs4x_wr(dac, 0x47, 0x80);
	rc |= cs4x_set(dac, 0x32, 1 << 7);
	rc |= cs4x_clr(dac, 0x32, 1 << 7);
	rc |= cs4x_wr(dac, 0, 0);

	// set the output to AUTO
	rc |= cs4x_output(dac, DAC_OUTPUT_AUTO);
	// Clock configuration: Auto detection
	rc |= cs4x_wr(dac, CS43L22_REG_Clocking_Ctl, 0x81);
	// Set the Slave Mode and the audio Standard
	rc |= cs4x_wr(dac, CS43L22_REG_Interface_Ctl_1, 0x04);

	// Set the Master volume
	rc |= cs4x_master_volume(dac, 169);

	// If the Speaker is enabled, set the Mono mode and volume attenuation level
	if (dac->cfg.out != DAC_OUTPUT_OFF
			&& dac->cfg.out != DAC_OUTPUT_HEADPHONE) {
		// Set the Speaker Mono mode
		rc |= cs4x_wr(dac, CS43L22_REG_Playback_Ctl_2, 0x06);
		rc |= cs4x_speaker_volume(dac, 0xff);
	}
	// Additional configuration for the CODEC. These configurations are done to reduce
	// the time needed for the Codec to power off. If these configurations are removed,
	// then a long delay should be added between powering off the Codec and switching
	// off the I2S peripheral MCLK clock (which is the operating clock for Codec).
	// If this delay is not inserted, then the codec will not shut down properly and
	// it results in high noise after shut down.

	// Disable the analog soft ramp
	rc |= cs4x_rmw(dac, CS43L22_REG_Analog_ZC_and_SR_Settings, 0x0f, 0x00);
	// Disable the digital soft ramp
	rc |= cs4x_wr(dac, CS43L22_REG_Misc_Ctl, 0x04);
	// Disable the limiter attack level
	rc |= cs4x_wr(dac, CS43L22_REG_Limit_Ctl_1_Thresholds, 0x00);
	// Adjust Bass and Treble levels
	rc |= cs4x_wr(dac, CS43L22_REG_Tone_Ctl, 0x0f);
	// Adjust PCM volume level
	rc |= cs4x_pcm_volume(dac, 241);

	exit: return rc;
}

//-----------------------------------------------------------------------------

int cs4x_start(struct cs4x_drv *dac) {
	// Enable the digital soft ramp
	int rc = cs4x_wr(dac, CS43L22_REG_Misc_Ctl, 0x06);
	// Enable Output device
	rc |= cs4x_mute_off(dac);
	// Power on the Codec
	rc |= cs4x_wr(dac, CS43L22_REG_Power_Ctl_1, 0x9e);
	return rc;
}

int cs4x_stop(struct cs4x_drv *dac) {
	// Mute the output
	int rc = cs4x_mute_on(dac);
	// Disable the digital soft ramp
	rc |= cs4x_wr(dac, CS43L22_REG_Misc_Ctl, 0x04);
	// Power down the DAC and the speaker (PMDAC and PMSPK bits)
	rc |= cs4x_wr(dac, CS43L22_REG_Power_Ctl_1, 0x9f);
	return rc;
}

int cs4x_pause(struct cs4x_drv *dac) {
	// Mute the output
	int rc = cs4x_mute_on(dac);
	// Put the Codec in Power save mode
	rc |= cs4x_wr(dac, CS43L22_REG_Power_Ctl_1, 0x01);
	return rc;
}

int cs4x_resume(struct cs4x_drv *dac) {
	// Unmute the output
	int rc = cs4x_mute_off(dac);
	// Power on the Codec
	rc |= cs4x_wr(dac, CS43L22_REG_Power_Ctl_1, 0x9e);
	return rc;
}
/* USER CODE END 0 */

/**
  * @brief  The application entry point.
  * @retval int
  */
int main(void)
{

  /* USER CODE BEGIN 1 */

  /* USER CODE END 1 */

  /* MCU Configuration--------------------------------------------------------*/

  /* Reset of all peripherals, Initializes the Flash interface and the Systick. */
  HAL_Init();

  /* USER CODE BEGIN Init */
	uint8_t buf[12];

  /* USER CODE END Init */

  /* Configure the system clock */
  SystemClock_Config();

  /* USER CODE BEGIN SysInit */

  /* USER CODE END SysInit */

  /* Initialize all configured peripherals */
  MX_GPIO_Init();
  MX_DMA_Init();
  MX_I2C1_Init();
  MX_I2S3_Init();
  MX_SPI1_Init();
  MX_USB_OTG_FS_PCD_Init();
  MX_ADC1_Init();
  MX_USART2_UART_Init();
  /* USER CODE BEGIN 2 */
	// EXT DAC INTIIALIZATION
	struct cs4x_cfg cfgdac;
	cfgdac.adr = DACADDR;
	cfgdac.out = DAC_OUTPUT_HEADPHONE;
	struct cs4x_drv dac;
	int rc = cs4x_init(&dac, &cfgdac);
	printf("CS4X init returned %d\r\n", rc);
	rc = cs4x_start(&dac);
	printf("CS4X start returned %d\r\n", rc);

	HAL_Delay(1);

	HAL_StatusTypeDef res;

	// Attempt to transmit audio data to DAC
	processData();
	outBufPtr = &dac_data[BUFFER_SIZE/2];
	processData();
	//outBufPtr = &dacData[BUFFER_SIZE / 2];
	//processData();
	res = HAL_I2S_Transmit_DMA(&hi2s3, (uint16_t*) dac_data, BUFFER_SIZE);
	//res = HAL_I2S_Transmit(&hi2s3, (uint16_t*) signal, nsamples,HAL_MAX_DELAY);
	if (res != HAL_OK) {
		printf("I2S - ERROR, res = %d!\r\n", res);
	}
	printf("loops after first two processes: %ld\r\n", (long)loops);

  /* USER CODE END 2 */

  /* Infinite loop */
  /* USER CODE BEGIN WHILE */
	while (1) {
    /* USER CODE END WHILE */

    /* USER CODE BEGIN 3 */

		if (data_ready_flag) {
			processData();

		}

	}

  /* USER CODE END 3 */
}

/**
  * @brief System Clock Configuration
  * @retval None
  */
void SystemClock_Config(void)
{
  RCC_OscInitTypeDef RCC_OscInitStruct = {0};
  RCC_ClkInitTypeDef RCC_ClkInitStruct = {0};

  /** Configure the main internal regulator output voltage
  */
  __HAL_RCC_PWR_CLK_ENABLE();
  __HAL_PWR_VOLTAGESCALING_CONFIG(PWR_REGULATOR_VOLTAGE_SCALE1);

  /** Initializes the RCC Oscillators according to the specified parameters
  * in the RCC_OscInitTypeDef structure.
  */
  RCC_OscInitStruct.OscillatorType = RCC_OSCILLATORTYPE_HSE;
  RCC_OscInitStruct.HSEState = RCC_HSE_ON;
  RCC_OscInitStruct.PLL.PLLState = RCC_PLL_ON;
  RCC_OscInitStruct.PLL.PLLSource = RCC_PLLSOURCE_HSE;
  RCC_OscInitStruct.PLL.PLLM = 8;
  RCC_OscInitStruct.PLL.PLLN = 336;
  RCC_OscInitStruct.PLL.PLLP = RCC_PLLP_DIV2;
  RCC_OscInitStruct.PLL.PLLQ = 7;
  if (HAL_RCC_OscConfig(&RCC_OscInitStruct) != HAL_OK)
  {
    Error_Handler();
  }

  /** Initializes the CPU, AHB and APB buses clocks
  */
  RCC_ClkInitStruct.ClockType = RCC_CLOCKTYPE_HCLK|RCC_CLOCKTYPE_SYSCLK
                              |RCC_CLOCKTYPE_PCLK1|RCC_CLOCKTYPE_PCLK2;
  RCC_ClkInitStruct.SYSCLKSource = RCC_SYSCLKSOURCE_PLLCLK;
  RCC_ClkInitStruct.AHBCLKDivider = RCC_SYSCLK_DIV1;
  RCC_ClkInitStruct.APB1CLKDivider = RCC_HCLK_DIV4;
  RCC_ClkInitStruct.APB2CLKDivider = RCC_HCLK_DIV2;

  if (HAL_RCC_ClockConfig(&RCC_ClkInitStruct, FLASH_LATENCY_5) != HAL_OK)
  {
    Error_Handler();
  }
}

/**
  * @brief ADC1 Initialization Function
  * @param None
  * @retval None
  */
static void MX_ADC1_Init(void)
{

  /* USER CODE BEGIN ADC1_Init 0 */

  /* USER CODE END ADC1_Init 0 */

  ADC_ChannelConfTypeDef sConfig = {0};

  /* USER CODE BEGIN ADC1_Init 1 */

  /* USER CODE END ADC1_Init 1 */

  /** Configure the global features of the ADC (Clock, Resolution, Data Alignment and number of conversion)
  */
  hadc1.Instance = ADC1;
  hadc1.Init.ClockPrescaler = ADC_CLOCK_SYNC_PCLK_DIV4;
  hadc1.Init.Resolution = ADC_RESOLUTION_8B;
  hadc1.Init.ScanConvMode = ENABLE;
  hadc1.Init.ContinuousConvMode = DISABLE;
  hadc1.Init.DiscontinuousConvMode = DISABLE;
  hadc1.Init.ExternalTrigConvEdge = ADC_EXTERNALTRIGCONVEDGE_NONE;
  hadc1.Init.ExternalTrigConv = ADC_SOFTWARE_START;
  hadc1.Init.DataAlign = ADC_DATAALIGN_RIGHT;
  hadc1.Init.NbrOfConversion = 7;
  hadc1.Init.DMAContinuousRequests = DISABLE;
  hadc1.Init.EOCSelection = ADC_EOC_SINGLE_CONV;
  if (HAL_ADC_Init(&hadc1) != HAL_OK)
  {
    Error_Handler();
  }

  /** Configure for the selected ADC regular channel its corresponding rank in the sequencer and its sample time.
  */
  sConfig.Channel = ADC_CHANNEL_1;
  sConfig.Rank = 1;
  sConfig.SamplingTime = ADC_SAMPLETIME_56CYCLES;
  if (HAL_ADC_ConfigChannel(&hadc1, &sConfig) != HAL_OK)
  {
    Error_Handler();
  }

  /** Configure for the selected ADC regular channel its corresponding rank in the sequencer and its sample time.
  */
  sConfig.Channel = ADC_CHANNEL_3;
  sConfig.Rank = 2;
  if (HAL_ADC_ConfigChannel(&hadc1, &sConfig) != HAL_OK)
  {
    Error_Handler();
  }

  /** Configure for the selected ADC regular channel its corresponding rank in the sequencer and its sample time.
  */
  sConfig.Channel = ADC_CHANNEL_8;
  sConfig.Rank = 3;
  if (HAL_ADC_ConfigChannel(&hadc1, &sConfig) != HAL_OK)
  {
    Error_Handler();
  }

  /** Configure for the selected ADC regular channel its corresponding rank in the sequencer and its sample time.
  */
  sConfig.Channel = ADC_CHANNEL_9;
  sConfig.Rank = 4;
  if (HAL_ADC_ConfigChannel(&hadc1, &sConfig) != HAL_OK)
  {
    Error_Handler();
  }

  /** Configure for the selected ADC regular channel its corresponding rank in the sequencer and its sample time.
  */
  sConfig.Channel = ADC_CHANNEL_11;
  sConfig.Rank = 5;
  if (HAL_ADC_ConfigChannel(&hadc1, &sConfig) != HAL_OK)
  {
    Error_Handler();
  }

  /** Configure for the selected ADC regular channel its corresponding rank in the sequencer and its sample time.
  */
  sConfig.Channel = ADC_CHANNEL_12;
  sConfig.Rank = 6;
  if (HAL_ADC_ConfigChannel(&hadc1, &sConfig) != HAL_OK)
  {
    Error_Handler();
  }

  /** Configure for the selected ADC regular channel its corresponding rank in the sequencer and its sample time.
  */
  sConfig.Channel = ADC_CHANNEL_14;
  sConfig.Rank = 7;
  if (HAL_ADC_ConfigChannel(&hadc1, &sConfig) != HAL_OK)
  {
    Error_Handler();
  }
  /* USER CODE BEGIN ADC1_Init 2 */

  /* USER CODE END ADC1_Init 2 */

}

/**
  * @brief I2C1 Initialization Function
  * @param None
  * @retval None
  */
static void MX_I2C1_Init(void)
{

  /* USER CODE BEGIN I2C1_Init 0 */

  /* USER CODE END I2C1_Init 0 */

  /* USER CODE BEGIN I2C1_Init 1 */

  /* USER CODE END I2C1_Init 1 */
  hi2c1.Instance = I2C1;
  hi2c1.Init.ClockSpeed = 100000;
  hi2c1.Init.DutyCycle = I2C_DUTYCYCLE_2;
  hi2c1.Init.OwnAddress1 = 0;
  hi2c1.Init.AddressingMode = I2C_ADDRESSINGMODE_7BIT;
  hi2c1.Init.DualAddressMode = I2C_DUALADDRESS_DISABLE;
  hi2c1.Init.OwnAddress2 = 0;
  hi2c1.Init.GeneralCallMode = I2C_GENERALCALL_DISABLE;
  hi2c1.Init.NoStretchMode = I2C_NOSTRETCH_DISABLE;
  if (HAL_I2C_Init(&hi2c1) != HAL_OK)
  {
    Error_Handler();
  }
  /* USER CODE BEGIN I2C1_Init 2 */

  /* USER CODE END I2C1_Init 2 */

}

/**
  * @brief I2S3 Initialization Function
  * @param None
  * @retval None
  */
static void MX_I2S3_Init(void)
{

  /* USER CODE BEGIN I2S3_Init 0 */

  /* USER CODE END I2S3_Init 0 */

  /* USER CODE BEGIN I2S3_Init 1 */

  /* USER CODE END I2S3_Init 1 */
  hi2s3.Instance = SPI3;
  hi2s3.Init.Mode = I2S_MODE_MASTER_TX;
  hi2s3.Init.Standard = I2S_STANDARD_PHILIPS;
  hi2s3.Init.DataFormat = I2S_DATAFORMAT_16B;
  hi2s3.Init.MCLKOutput = I2S_MCLKOUTPUT_ENABLE;
  hi2s3.Init.AudioFreq = I2S_AUDIOFREQ_32K;
  hi2s3.Init.CPOL = I2S_CPOL_LOW;
  hi2s3.Init.ClockSource = I2S_CLOCK_PLL;
  hi2s3.Init.FullDuplexMode = I2S_FULLDUPLEXMODE_DISABLE;
  if (HAL_I2S_Init(&hi2s3) != HAL_OK)
  {
    Error_Handler();
  }
  /* USER CODE BEGIN I2S3_Init 2 */

  /* USER CODE END I2S3_Init 2 */

}

/**
  * @brief SPI1 Initialization Function
  * @param None
  * @retval None
  */
static void MX_SPI1_Init(void)
{

  /* USER CODE BEGIN SPI1_Init 0 */

  /* USER CODE END SPI1_Init 0 */

  /* USER CODE BEGIN SPI1_Init 1 */

  /* USER CODE END SPI1_Init 1 */
  /* SPI1 parameter configuration*/
  hspi1.Instance = SPI1;
  hspi1.Init.Mode = SPI_MODE_MASTER;
  hspi1.Init.Direction = SPI_DIRECTION_2LINES;
  hspi1.Init.DataSize = SPI_DATASIZE_8BIT;
  hspi1.Init.CLKPolarity = SPI_POLARITY_LOW;
  hspi1.Init.CLKPhase = SPI_PHASE_1EDGE;
  hspi1.Init.NSS = SPI_NSS_SOFT;
  hspi1.Init.BaudRatePrescaler = SPI_BAUDRATEPRESCALER_2;
  hspi1.Init.FirstBit = SPI_FIRSTBIT_MSB;
  hspi1.Init.TIMode = SPI_TIMODE_DISABLE;
  hspi1.Init.CRCCalculation = SPI_CRCCALCULATION_DISABLE;
  hspi1.Init.CRCPolynomial = 10;
  if (HAL_SPI_Init(&hspi1) != HAL_OK)
  {
    Error_Handler();
  }
  /* USER CODE BEGIN SPI1_Init 2 */

  /* USER CODE END SPI1_Init 2 */

}

/**
  * @brief USART2 Initialization Function
  * @param None
  * @retval None
  */
static void MX_USART2_UART_Init(void)
{

  /* USER CODE BEGIN USART2_Init 0 */

  /* USER CODE END USART2_Init 0 */

  /* USER CODE BEGIN USART2_Init 1 */

  /* USER CODE END USART2_Init 1 */
  huart2.Instance = USART2;
  huart2.Init.BaudRate = 31250;
  huart2.Init.WordLength = UART_WORDLENGTH_8B;
  huart2.Init.StopBits = UART_STOPBITS_1;
  huart2.Init.Parity = UART_PARITY_NONE;
  huart2.Init.Mode = UART_MODE_TX_RX;
  huart2.Init.HwFlowCtl = UART_HWCONTROL_NONE;
  huart2.Init.OverSampling = UART_OVERSAMPLING_16;
  if (HAL_UART_Init(&huart2) != HAL_OK)
  {
    Error_Handler();
  }
  /* USER CODE BEGIN USART2_Init 2 */

  /* USER CODE END USART2_Init 2 */

}

/**
  * @brief USB_OTG_FS Initialization Function
  * @param None
  * @retval None
  */
static void MX_USB_OTG_FS_PCD_Init(void)
{

  /* USER CODE BEGIN USB_OTG_FS_Init 0 */

  /* USER CODE END USB_OTG_FS_Init 0 */

  /* USER CODE BEGIN USB_OTG_FS_Init 1 */

  /* USER CODE END USB_OTG_FS_Init 1 */
  hpcd_USB_OTG_FS.Instance = USB_OTG_FS;
  hpcd_USB_OTG_FS.Init.dev_endpoints = 4;
  hpcd_USB_OTG_FS.Init.speed = PCD_SPEED_FULL;
  hpcd_USB_OTG_FS.Init.dma_enable = DISABLE;
  hpcd_USB_OTG_FS.Init.phy_itface = PCD_PHY_EMBEDDED;
  hpcd_USB_OTG_FS.Init.Sof_enable = DISABLE;
  hpcd_USB_OTG_FS.Init.low_power_enable = DISABLE;
  hpcd_USB_OTG_FS.Init.lpm_enable = DISABLE;
  hpcd_USB_OTG_FS.Init.vbus_sensing_enable = ENABLE;
  hpcd_USB_OTG_FS.Init.use_dedicated_ep1 = DISABLE;
  if (HAL_PCD_Init(&hpcd_USB_OTG_FS) != HAL_OK)
  {
    Error_Handler();
  }
  /* USER CODE BEGIN USB_OTG_FS_Init 2 */

  /* USER CODE END USB_OTG_FS_Init 2 */

}

/**
  * Enable DMA controller clock
  */
static void MX_DMA_Init(void)
{

  /* DMA controller clock enable */
  __HAL_RCC_DMA1_CLK_ENABLE();
  __HAL_RCC_DMA2_CLK_ENABLE();

  /* DMA interrupt init */
  /* DMA1_Stream5_IRQn interrupt configuration */
  HAL_NVIC_SetPriority(DMA1_Stream5_IRQn, 0, 0);
  HAL_NVIC_EnableIRQ(DMA1_Stream5_IRQn);
  /* DMA1_Stream7_IRQn interrupt configuration */
  HAL_NVIC_SetPriority(DMA1_Stream7_IRQn, 0, 0);
  HAL_NVIC_EnableIRQ(DMA1_Stream7_IRQn);
  /* DMA2_Stream0_IRQn interrupt configuration */
  HAL_NVIC_SetPriority(DMA2_Stream0_IRQn, 0, 0);
  HAL_NVIC_EnableIRQ(DMA2_Stream0_IRQn);

}

/**
  * @brief GPIO Initialization Function
  * @param None
  * @retval None
  */
static void MX_GPIO_Init(void)
{
  GPIO_InitTypeDef GPIO_InitStruct = {0};
  /* USER CODE BEGIN MX_GPIO_Init_1 */

  /* USER CODE END MX_GPIO_Init_1 */

  /* GPIO Ports Clock Enable */
  __HAL_RCC_GPIOE_CLK_ENABLE();
  __HAL_RCC_GPIOC_CLK_ENABLE();
  __HAL_RCC_GPIOH_CLK_ENABLE();
  __HAL_RCC_GPIOA_CLK_ENABLE();
  __HAL_RCC_GPIOB_CLK_ENABLE();
  __HAL_RCC_GPIOD_CLK_ENABLE();

  /*Configure GPIO pin Output Level */
  HAL_GPIO_WritePin(GPIOE, pre0_Pin|pre1_Pin, GPIO_PIN_SET);

  /*Configure GPIO pin Output Level */
  HAL_GPIO_WritePin(CS_I2C_SPI_GPIO_Port, CS_I2C_SPI_Pin, GPIO_PIN_RESET);

  /*Configure GPIO pin Output Level */
  HAL_GPIO_WritePin(GPIOC, doodle_Pin|OTG_FS_PowerSwitchOn_Pin|vibrato_Pin|fxx_Pin, GPIO_PIN_SET);

  /*Configure GPIO pin Output Level */
  HAL_GPIO_WritePin(GPIOD, LD4_Pin|LD3_Pin|LD5_Pin|LD6_Pin
                          |Audio_RST_Pin, GPIO_PIN_RESET);

  /*Configure GPIO pin Output Level */
  HAL_GPIO_WritePin(trem_GPIO_Port, trem_Pin, GPIO_PIN_SET);

  /*Configure GPIO pin Output Level */
  HAL_GPIO_WritePin(arpeggio_GPIO_Port, arpeggio_Pin, GPIO_PIN_SET);

  /*Configure GPIO pin Output Level */
  HAL_GPIO_WritePin(GPIOB, poly_Pin|legato_Pin|pre2_Pin, GPIO_PIN_SET);

  /*Configure GPIO pins : pre0_Pin pre1_Pin */
  GPIO_InitStruct.Pin = pre0_Pin|pre1_Pin;
  GPIO_InitStruct.Mode = GPIO_MODE_OUTPUT_PP;
  GPIO_InitStruct.Pull = GPIO_PULLUP;
  GPIO_InitStruct.Speed = GPIO_SPEED_FREQ_LOW;
  HAL_GPIO_Init(GPIOE, &GPIO_InitStruct);

  /*Configure GPIO pin : CS_I2C_SPI_Pin */
  GPIO_InitStruct.Pin = CS_I2C_SPI_Pin;
  GPIO_InitStruct.Mode = GPIO_MODE_OUTPUT_PP;
  GPIO_InitStruct.Pull = GPIO_NOPULL;
  GPIO_InitStruct.Speed = GPIO_SPEED_FREQ_LOW;
  HAL_GPIO_Init(CS_I2C_SPI_GPIO_Port, &GPIO_InitStruct);

  /*Configure GPIO pins : doodle_button_Pin preset_button_Pin */
  GPIO_InitStruct.Pin = doodle_button_Pin|preset_button_Pin;
  GPIO_InitStruct.Mode = GPIO_MODE_INPUT;
  GPIO_InitStruct.Pull = GPIO_NOPULL;
  HAL_GPIO_Init(GPIOE, &GPIO_InitStruct);

  /*Configure GPIO pins : doodle_Pin OTG_FS_PowerSwitchOn_Pin */
  GPIO_InitStruct.Pin = doodle_Pin|OTG_FS_PowerSwitchOn_Pin;
  GPIO_InitStruct.Mode = GPIO_MODE_OUTPUT_PP;
  GPIO_InitStruct.Pull = GPIO_NOPULL;
  GPIO_InitStruct.Speed = GPIO_SPEED_FREQ_LOW;
  HAL_GPIO_Init(GPIOC, &GPIO_InitStruct);

  /*Configure GPIO pin : PDM_OUT_Pin */
  GPIO_InitStruct.Pin = PDM_OUT_Pin;
  GPIO_InitStruct.Mode = GPIO_MODE_AF_PP;
  GPIO_InitStruct.Pull = GPIO_NOPULL;
  GPIO_InitStruct.Speed = GPIO_SPEED_FREQ_LOW;
  GPIO_InitStruct.Alternate = GPIO_AF5_SPI2;
  HAL_GPIO_Init(PDM_OUT_GPIO_Port, &GPIO_InitStruct);

  /*Configure GPIO pin : B1_Pin */
  GPIO_InitStruct.Pin = B1_Pin;
  GPIO_InitStruct.Mode = GPIO_MODE_IT_RISING;
  GPIO_InitStruct.Pull = GPIO_NOPULL;
  HAL_GPIO_Init(B1_GPIO_Port, &GPIO_InitStruct);

  /*Configure GPIO pins : BOOT1_Pin PLA_button_Pin */
  GPIO_InitStruct.Pin = BOOT1_Pin|PLA_button_Pin;
  GPIO_InitStruct.Mode = GPIO_MODE_INPUT;
  GPIO_InitStruct.Pull = GPIO_NOPULL;
  HAL_GPIO_Init(GPIOB, &GPIO_InitStruct);

  /*Configure GPIO pin : CLK_IN_Pin */
  GPIO_InitStruct.Pin = CLK_IN_Pin;
  GPIO_InitStruct.Mode = GPIO_MODE_AF_PP;
  GPIO_InitStruct.Pull = GPIO_NOPULL;
  GPIO_InitStruct.Speed = GPIO_SPEED_FREQ_LOW;
  GPIO_InitStruct.Alternate = GPIO_AF5_SPI2;
  HAL_GPIO_Init(CLK_IN_GPIO_Port, &GPIO_InitStruct);

  /*Configure GPIO pins : LD4_Pin LD3_Pin LD5_Pin LD6_Pin */
  GPIO_InitStruct.Pin = LD4_Pin|LD3_Pin|LD5_Pin|LD6_Pin;
  GPIO_InitStruct.Mode = GPIO_MODE_OUTPUT_PP;
  GPIO_InitStruct.Pull = GPIO_NOPULL;
  GPIO_InitStruct.Speed = GPIO_SPEED_FREQ_LOW;
  HAL_GPIO_Init(GPIOD, &GPIO_InitStruct);

  /*Configure GPIO pins : vibrato_Pin fxx_Pin */
  GPIO_InitStruct.Pin = vibrato_Pin|fxx_Pin;
  GPIO_InitStruct.Mode = GPIO_MODE_OUTPUT_PP;
  GPIO_InitStruct.Pull = GPIO_PULLUP;
  GPIO_InitStruct.Speed = GPIO_SPEED_FREQ_LOW;
  HAL_GPIO_Init(GPIOC, &GPIO_InitStruct);

  /*Configure GPIO pin : trem_Pin */
  GPIO_InitStruct.Pin = trem_Pin;
  GPIO_InitStruct.Mode = GPIO_MODE_OUTPUT_PP;
  GPIO_InitStruct.Pull = GPIO_PULLUP;
  GPIO_InitStruct.Speed = GPIO_SPEED_FREQ_LOW;
  HAL_GPIO_Init(trem_GPIO_Port, &GPIO_InitStruct);

  /*Configure GPIO pins : FX_button_Pin OTG_FS_OverCurrent_Pin */
  GPIO_InitStruct.Pin = FX_button_Pin|OTG_FS_OverCurrent_Pin;
  GPIO_InitStruct.Mode = GPIO_MODE_INPUT;
  GPIO_InitStruct.Pull = GPIO_NOPULL;
  HAL_GPIO_Init(GPIOD, &GPIO_InitStruct);

  /*Configure GPIO pins : Audio_RST_Pin arpeggio_Pin */
  GPIO_InitStruct.Pin = Audio_RST_Pin|arpeggio_Pin;
  GPIO_InitStruct.Mode = GPIO_MODE_OUTPUT_PP;
  GPIO_InitStruct.Pull = GPIO_PULLUP;
  GPIO_InitStruct.Speed = GPIO_SPEED_FREQ_LOW;
  HAL_GPIO_Init(GPIOD, &GPIO_InitStruct);

  /*Configure GPIO pins : poly_Pin legato_Pin pre2_Pin */
  GPIO_InitStruct.Pin = poly_Pin|legato_Pin|pre2_Pin;
  GPIO_InitStruct.Mode = GPIO_MODE_OUTPUT_PP;
  GPIO_InitStruct.Pull = GPIO_PULLUP;
  GPIO_InitStruct.Speed = GPIO_SPEED_FREQ_LOW;
  HAL_GPIO_Init(GPIOB, &GPIO_InitStruct);

  /*Configure GPIO pin : MEMS_INT2_Pin */
  GPIO_InitStruct.Pin = MEMS_INT2_Pin;
  GPIO_InitStruct.Mode = GPIO_MODE_EVT_RISING;
  GPIO_InitStruct.Pull = GPIO_NOPULL;
  HAL_GPIO_Init(MEMS_INT2_GPIO_Port, &GPIO_InitStruct);

  /* EXTI interrupt init*/
  HAL_NVIC_SetPriority(EXTI0_IRQn, 0, 0);
  HAL_NVIC_EnableIRQ(EXTI0_IRQn);

  /* USER CODE BEGIN MX_GPIO_Init_2 */

  /* USER CODE END MX_GPIO_Init_2 */
}

/* USER CODE BEGIN 4 */
int _write(int file, char *ptr, int len) {
	(void) file;
	int DataIdx;

	for (DataIdx = 0; DataIdx < len; DataIdx++) {
		ITM_SendChar(*ptr++);
	}
	return len;
}
/* USER CODE END 4 */

/**
  * @brief  This function is executed in case of error occurrence.
  * @retval None
  */
void Error_Handler(void)
{
  /* USER CODE BEGIN Error_Handler_Debug */
	/* User can add his own implementation to report the HAL error return state */
	__disable_irq();
	while (1) {
		printf("Error\r\n");
	}
  /* USER CODE END Error_Handler_Debug */
}

#ifdef  USE_FULL_ASSERT
/**
  * @brief  Reports the name of the source file and the source line number
  *         where the assert_param error has occurred.
  * @param  file: pointer to the source file name
  * @param  line: assert_param error line source number
  * @retval None
  */
void assert_failed(uint8_t *file, uint32_t line)
{
  /* USER CODE BEGIN 6 */
  /* User can add his own implementation to report the file name and line number,
     ex: printf("Wrong parameters value: file %s on line %d\r\n", file, line) */
  /* USER CODE END 6 */
}
#endif /* USE_FULL_ASSERT */
